## drivers/display/Kconfig.hpmicro
```kconfig
# Copyright 2024 HPMicro
# SPDX-License-Identifier: Apache-2.0


menuconfig DISPLAY_HPMICRO
	bool "HPMicro DISPLAY driver"
	default y
	depends on DT_HAS_HPMICRO_HPM_LCDC_ENABLED
	select DISPLAY
	select HAS_HPMSDK_LCDC
	help
		Enable the hpmicro display driver.

if DISPLAY_HPMICRO
config HPM_DISPLAY_RGB
	bool "Support rgb panel"
	default y
	depends on DT_HAS_HPMICRO_HPM_DISPLAY_RGB_ENABLED

config HPM_DISPLAY_PIXELMUX
	bool "HPMicro PIXELMUX MODULE"
	default y
	depends on DT_HAS_HPMICRO_HPM_PIXELMUX_ENABLED
	select HAS_HPMSDK_PIXELMUX
	help
		Enable HPMicro PIXELMUX module

if HPM_DISPLAY_PIXELMUX
config HPM_DISPLAY_MIPI_DSI
	bool "Support mipi_dsi panel"
	default y
	depends on DT_HAS_HPMICRO_HPM_DISPLAY_MIPI_ENABLED
	select HAS_HPMSDK_MIPI_DSI
	select HAS_HPMSDK_MIPI_DSI_PHY

config HPM_DISPLAY_LVDS
	bool "Support lvds panel"
	default y
	depends on DT_HAS_HPMICRO_HPM_DISPLAY_LVDS_ENABLED
	select HAS_HPMSDK_LVB
endif
endif
```

## drivers/dma/Kconfig.hpmicro
```kconfig
# Copyright (c) 2024 HPMicro
# SPDX-License-Identifier: Apache-2.0
DT_COMPAT_HPM_DMA := hpmicro,hpm-dma
DT_COMPAT_HPM_DMAV2 := hpmicro,hpm-dmav2

config DMA_HPMICRO
	bool "HPMICRO DMA driver"
	default y
	depends on DT_HAS_HPMICRO_HPM_DMA_ENABLED
	select HAS_HPMSDK_DMA
	help
	  This option enables the DMA driver for HPM SoC family.

config DMAV2_HPMICRO
	bool "HPMICRO DMAV2 driver"
	default y
	depends on DT_HAS_HPMICRO_HPM_DMAV2_ENABLED
	select HAS_HPMSDK_DMAV2
	help
	  This option enables the DMAV2 driver for HPM SoC family.
```

## drivers/ethernet/Kconfig.hpmicro
```kconfig
# Copyright (c) 2025 HPMicro
# SPDX-License-Identifier: Apache-2.0

DT_COMPAT_HPM_ETH := hpmicro,hpm-eth

config ETH_HPMICRO
	bool "HPMICRO Ethernet driver"
	default y
	depends on DT_HAS_HPMICRO_HPM_ETH_ENABLED
	select HAS_HPMSDK_ENET
	help
		Enable the HPMICRO Ethernet driver.

	menu "ETH device driver configurations"
	depends on ETH_HPMICRO
		# RX thread parameter setting
		config ETH_HPM_RX_THREAD_PRIO
		int "RX thread priority"
		default 2

		config ETH_HPM_RX_THREAD_STACK_SIZE
		int "RX thread stack size"
		default 8192
		# end of RX thread parameter setting

		# delay chain setting
		config ETH_HPM_TX_DELAY
			int "TX delay"
			default 0
			range 0 31
			help
			TX delay

		config ETH_HPM_RX_DELAY
			int "RX delay"
			default 7
			range 0 31
			help
			RX delay
		# end of delay chain setting

		# promiscuous mode setting
		config ETH_HPM_PROMISCUOUS_MODE
			bool "promiscuous mode"
			default n
		# end of promiscuous mode setting

		# buffer Setting
		config ETH_HPM_RX_BUFF_COUNT
			int "RX buffer count"
			default 20
			help
			RX buffer count

		config ETH_HPM_TX_BUFF_COUNT
			int "TX buffer count"
			default 10
			help
			TX buffer count

		config ETH_HPM_RX_BUFF_SIZE
			int "RX buffer size"
			default 1536
			help
			RX buffer size

		config ETH_HPM_TX_BUFF_SIZE
			int "TX buffer size"
			default 1536
			help
			TX buffer size
		# end of buffer Setting

		# MAC setting
        config ETH_HPM_MAC_ADDR0
			hex "MAC_ADDR0"
			range 0 ff
			default 98

        config ETH_HPM_MAC_ADDR1
			hex "MAC_ADDR1"
			range 0 ff
			default 2C

        config ETH_HPM_MAC_ADDR2
			hex "MAC_ADDR2"
			range 0 ff
			default BC

        config ETH_HPM_MAC_ADDR3
			hex "MAC_ADDR3"
			range 0 ff
			default B1

        config ETH_HPM_MAC_ADDR4
			hex "MAC_ADDR4"
			range 0 ff
			default 9F

        config ETH_HPM_MAC_ADDR5
			hex "MAC_ADDR5"
			range 0 ff
			default 17
		# end of MAC setting

		# interface type selection
		choice
			prompt "Interface Type"
			default ETH_HPM_RGMII

			config ETH_HPM_RGMII
			bool "RGMII"

			config ETH_HPM_RMII
			bool "RMII"
		endchoice # end of interface type selection

		# use selection of phy on board
		config ETH_PHY
			bool "Use Eethernet PHY On Board"
			default y

		config ETH_PHY_RTL8211
			bool
			default y
			depends on ETH_PHY && ETH_HPM_RGMII

		config ETH_PHY_RTL8201
			bool
			default y
			depends on ETH_PHY && ETH_HPM_RMII

		# end of use selection of phy on board

		# refeclk setting
		if ETH_HPM_RMII
			choice
				prompt "Ref Clock"
				default ETH_RMII_REFCLK_INT

				config ETH_RMII_REFCLK_INT
				bool "Internal RefClk"

				config ETH_RMII_REFCLK_EXT
				bool "External RefClk"
			endchoice

			config ETH_RMII_REFCLK
			int
			default 1
			depends on ETH_HPM_RMII && ETH_RMII_REFCLK_INT

			config ETH_RMII_REFCLK
			int
			default 0
			depends on ETH_HPM_RMII && ETH_RMII_REFCLK_EXT
		endif # ETH_HPM_RMII

        # end Of REFClk Setting

	endmenu # ETH device driver options
```

## drivers/gpio/Kconfig.hpmicro
```kconfig
# Copyright 2024 HPMicro
# SPDX-License-Identifier: Apache-2.0

DT_COMPAT_HPMICRO_HPM_GPIO := hpmicro,hpm-gpio

config GPIO_HPMICRO
	bool "HPMicro GPIO driver"
	default y
	depends on DT_HAS_HPMICRO_HPM_GPIO_ENABLED
	select HAS_HPMSDK_GPIO
	help
	  Enable the hpmicro gpio driver.
```

## drivers/i2c/Kconfig.hpmicro
```kconfig
# Copyright 2024 HPMicro
# SPDX-License-Identifier: Apache-2.0

DT_COMPAT_HPMICRO_HPM_I2C := hpmicro,hpm-i2c

config I2C_HPMICRO
	bool "HPMicro I2C driver"
	default y
	depends on DT_HAS_HPMICRO_HPM_I2C_ENABLED
	select HAS_HPMSDK_I2C
	help
	  Enable the hpmicro i2c driver.
```

## drivers/memc/Kconfig.hpmicro
```kconfig
# Copyright 2024 HPMicro
# SPDX-License-Identifier: Apache-2.0

DT_COMPAT_HPMICRO_HPM_DDR := hpmicro,hpm-ddr
DT_COMPAT_HPMICRO_HPM_FEMC := hpmicro,hpm-femc

config DDR_HPMICRO
	bool "HPMicro DDR driver"
	default y
	depends on DT_HAS_HPMICRO_HPM_DDR_ENABLED
	help
	  Enable the hpmicro ddr driver.

config FEMC_HPMICRO
	bool "HPMicro FEMC driver"
	default y
	depends on DT_HAS_HPMICRO_HPM_FEMC_ENABLED
	help
	  Enable the hpmicro femc driver.
```

## drivers/pinctrl/Kconfig.hpmicro
```kconfig
# Copyright 2024 hpmicro
# SPDX-License-Identifier: Apache-2.0

DT_COMPAT_HPM_PINCTRL := hpmicro,hpm-pinctrl

config PINCTRL_HPMICRO
	bool "Pin controller driver for HPMicro MCUs"
	depends on DT_HAS_HPMICRO_HPM_PINCTRL_ENABLED
	select HAS_HPMSDK_PINCTRL
	default y
	help
	  Enable pin controller driver for HPMicro series MCUs
```

## drivers/pwm/Kconfig.hpmicro
```kconfig
# Copyright (c) 2024 HPMicro
# SPDX-License-Identifier: Apache-2.0
DT_COMPAT_HPM_PWM := hpmicro,hpm-pwm

config PWM_HPMICRO
	bool "HPMicro PWM driver"
	default y
	depends on DT_HAS_HPMICRO_HPM_PWM_ENABLED
	select HAS_HPMSDK_PWM
	help
	  Enable hpmicro pwm driver.
```

## drivers/sdhc/Kconfig.hpmicro
```kconfig
# HPMICRO CASTCAN configuration options

# Copyright (c) 2022-2024 HPMicro
# SPDX-License-Identifier: Apache-2.0

DT_COMPAT_HPM_SDHC := hpmicro,hpm-sdhc

config SDHC_HPMICRO
    bool "HPMICRO SDHC driver"
    default y
    depends on DT_HAS_HPMICRO_HPM_SDHC_ENABLED
    select HAS_HPMSDK_SDXC
    select SDHC_SUPPORTS_NATIVE_MODE if SD_STACK
    select SDHC_SUPPORTS_UHS if SD_STACK
    select SD_UHS_PROTOCOL if SD_STACK
    help
        Enable the HPMICRO SDHC driver
```

## drivers/serial/Kconfig.hpmicro
```kconfig
# Copyright (c) 2024 HPMicro
# SPDX-License-Identifier: Apache-2.0
DT_COMPAT_HPM_UART := hpmicro,hpm-uart

config UART_HPMICRO
	bool "HPMICRO serial driver"
	default y
	depends on DT_HAS_HPMICRO_HPM_UART_ENABLED
	select HAS_HPMSDK_UART
	select SERIAL_HAS_DRIVER
	select SERIAL_SUPPORT_INTERRUPT
	select SERIAL_SUPPORT_ASYNC
	select HAS_HPMSDK_GPTMR if SERIAL_SUPPORT_ASYNC
	select HAS_HPMSDK_DMA if SERIAL_SUPPORT_ASYNC
	select DMA if SERIAL_SUPPORT_ASYNC
	help
	  This option enables the UART driver for HPM SoC family.
```

## drivers/spi/Kconfig.hpmicro
```kconfig
# Copyright (c) 2024 HPMicro
# SPDX-License-Identifier: Apache-2.0
DT_COMPAT_HPM_SPI := hpmicro,hpm-spi

config SPI_HPMICRO
	bool "HPMicro SPI driver"
	default y
	depends on DT_HAS_HPMICRO_HPM_SPI_ENABLED
	select HAS_HPMSDK_SPI
	select SPI
	help
	  Enable support for hpmicro spi driver.

if SPI_HPMICRO
config SPI_HPM_SPI_DMA
	bool "HPM SPI DMA Support"
	select DMA
	help
	  Enable the SPI DMA mode for SPI instances
	  that enable dma channels in their device tree node.
endif # SPI_HPM
```

## drivers/usb/cherryusb/Kconfig.hpmicro
```kconfig
# Copyright (c) 2025 HPMicro
# SPDX-License-Identifier: Apache-2.0

DT_COMPAT_HPM_CHERYUSB := hpmicro,hpm-cherryusb

config CHERRYUSB_HPMICRO
	bool "HPMicro CherryUSB controller driver"
	default y
	depends on DT_HAS_HPMICRO_HPM_CHERRYUSB_ENABLED
	select HAS_HPMSDK_USB
	help
	  Enable support for hpmicro cherryusb driver.
```

## drivers/usb/cherryusb/device/Kconfig.hpmicro
```kconfig
# Copyright (c) 2025 HPMicro
# SPDX-License-Identifier: Apache-2.0

DT_COMPAT_HPM_CHERYUSB_DEVICE := hpmicro,hpm-cherryusb-device

config CHERRYUSB_DEVICE_HPMICRO
	bool "HPMicro CherryUSB device controller driver"
	default y
	depends on DT_HAS_HPMICRO_HPM_CHERRYUSB_DEVICE_ENABLED
	select HAS_HPMSDK_USB
	help
	  Enable support for hpmicro cherryusb device driver.
```

## drivers/usb/cherryusb/host/Kconfig.hpmicro
```kconfig
# Copyright (c) 2025 HPMicro
# SPDX-License-Identifier: Apache-2.0

DT_COMPAT_HPM_CHERYUSB_HOST := hpmicro,hpm-cherryusb-host

config CHERRYUSB_HOST_HPMICRO
	bool "HPMicro CherryUSB host controller driver"
	default y
	depends on DT_HAS_HPMICRO_HPM_CHERRYUSB_HOST_ENABLED
	select HAS_HPMSDK_USB
	help
	  Enable support for hpmicro cherryusb host driver.
```

## drivers/video/Kconfig.hpmicro
```kconfig
# Copyright 2024 HPMicro
# SPDX-License-Identifier: Apache-2.0

config CAMERA_HPMICRO
	bool "HPMicro CAMERA driver"
	default y
	depends on DT_HAS_HPMICRO_HPM_CAMERA_ENABLED
	select HAS_HPMSDK_CAM
	select VIDEO
	help
	  Enable the hpmicro cam driver.

config CAMERA_HPMICRO_INIT_PRIORITY
	int "CAMERA HPMICRO init priority"
	default 50
	depends on CAMERA_HPMICRO
	help
	  Initialization priority for the CAM(MIPI CSI and DVP) interface on an HPMicro device.

config MIPI_CSI_HPMICRO
	bool "HPMicro MIPI CSI driver"
	default y
	depends on DT_HAS_HPMICRO_HPM_MIPI_CSI_ENABLED
	select HAS_HPMSDK_MIPI_CSI
	select HAS_HPMSDK_MIPI_CSI_PHY
	help
	  Enable the hpmicro mipi csi driver.

config VIDEO_HPMICRO_INIT_PRIORITY
	int "VIDEO HPMICRO init priority"
	default 60
	depends on VIDEO
	help
	  Initialization priority for the VIDEO on an HPMicro device.

if SOC_SERIES_HPM6800

config CAMERA_PIXELMUX_HPMICRO
	bool
	default y
	select HAS_HPMSDK_PIXELMUX
	help
	  Enable the hpmicro camera pixel mux driver

endif
```

## dts/bindings/adc/hpmicro,hpm-adc16.yaml
```yaml
# Copyright 2022 hpmicro
# SPDX-License-Identifier: Apache-2.0

description: HPMicro HPM ADC

compatible: "hpmicro,hpm-adc16"

include: [adc-controller.yaml, pinctrl-device.yaml]

properties:
    reg:
      required: true

    interrupts:
      required: true

    clocks:
      required: true

    sample-time:
      type: int
      required: true
      description: sample time in clock cycles

    en-hw-trig:
      type: boolean
      required: false
      description: enables hardware triggered adc sampling

    trig-input-src:
      type: int
      required: false
      description: |
        interconnection manager input resources
        HPM_TRGM0_INPUT_SRC_VSS 0x0
        HPM_TRGM0_INPUT_SRC_VDD 0x1
        HPM_TRGM0_INPUT_SRC_TRGM0_IN0 0x2
        HPM_TRGM0_INPUT_SRC_TRGM0_IN1 0x3
        HPM_TRGM0_INPUT_SRC_TRGM0_IN2 0x4
        ....
        HPM_TRGM0_INPUT_SRC_DEBUG_FLAG 0x38

    trig-base:
      type: int
      required: false
      description: |
        interconnection manager base address
        HPM_TRGM0_BASE 0xF020C000UL
        HPM_TRGM1_BASE 0xF021C000UL
        HPM_TRGM2_BASE 0xF022C000UL
        HPM_TRGM3_BASE 0xF023C000UL


    trig-num:
      type: int
      required: false
      description: |
        interconnection manager number
        TRGM_TRGOCFG_ADC0_STRGI 48
        TRGM_TRGOCFG_ADC1_STRGI 49
        TRGM_TRGOCFG_ADC2_STRGI 50
        TRGM_TRGOCFG_ADC3_STRGI 51

    "#io-channel-cells":
      const: 1

    pinctrl-0:
      required: true

    pinctrl-names:
      required: true

io-channel-cells:
    - input
```

## dts/bindings/can/hpmicro,hpm-can.yaml
```yaml
# Copyright 2022 hpmicro
# SPDX-License-Identifier: Apache-2.0

description: HPMicro HPM CAN

compatible: "hpmicro,hpm-can"

include: ["can-controller.yaml","pinctrl-device.yaml"]

properties:
  reg:
    required: true

  interrupts:
    required: true

  clk-name:
    type: int
    required: true
    description: CAN clock name

  clk-source:
    type: int
    required: true
    description: CAN clock source

  clk-divider:
    type: int
    required: true
    description: CAN clock divider
```

## dts/bindings/clock/hpmicro,hpm-clock.yaml
```yaml
# Copyright (c) 2022 HPMicro
# SPDX-License-Identifier: Apache-2.0

description: HPMicro Clock

compatible: "hpmicro,hpm-clock"

include: [clock-controller.yaml, base.yaml]

properties:
  reg:
    required: true

  "#clock-cells":
    const: 3

clock-cells:
  - name
  - src
  - div
```

## dts/bindings/clock/hpmicro,hpm-pll.yaml
```yaml
# Copyright (c) 2022 HPMicro
# SPDX-License-Identifier: Apache-2.0

description: HPMicro Clock

compatible: "hpmicro,hpm-pll"

include: [clock-controller.yaml, base.yaml]

properties:
  reg:
    required: true

  clock-sys-core:
    required: true
    type: int
    description: Configuring the core of the clock. 0 or 1

  ram-up-time:
    required: true
    type: int
    description: Configure the External OSC ramp-up time. 32KHZ clock

  sysctl-present:
    type: int
    required: true
    description: |
      Clock presets
    enum:
      - 1
      - 2
      - 4
      - 8
      - 16
      - 32
      - 64
      - 128

  clock-frequency:
    required: true
    type: int
    description: Clock Frequency HZ

  "#clock-cells":
    const: 3

clock-cells:
  - name
  - src
  - div
```

## dts/bindings/display/hpmicro,hpm-display-lvds.yaml
```yaml
# Copyright 2024 HPMicro
# SPDX-License-Identifier: Apache-2.0

description: HPMicro LVDS DISPLAY

compatible: "hpmicro,hpm-display-lvds"

include: ["base.yaml","pinctrl-device.yaml", "hpmicro,hpm-display.yaml"]

properties:
    dual_lvds_phy:
      type: boolean
      description: lvds phy is lvds_dual
```

## dts/bindings/display/hpmicro,hpm-display-mipi.yaml
```yaml
# Copyright 2024 HPMicro
# SPDX-License-Identifier: Apache-2.0

description: HPMicro HPM MIPI DISPLAY

compatible: "hpmicro,hpm-display-mipi"

include: ["base.yaml","pinctrl-device.yaml", "hpmicro,hpm-display.yaml"]

properties:
  mipi_lane_num:
    type: int
    enum:
      - 1
      - 2
      - 3
      - 4
  mipi_lane_speed:
    type: int
    description: uint Mbps
  mipi_cmd:
    type: uint8-array
    description: |
      mipi panel init commond.
      [len, delay, data0, data1...., ]
      len: delay + datas. at least is 1 (only delay).
      delay: delay before send the cmd. uint is ms. the delay domain is mandatory and it >= 0.
      data: mipi commond data. optional
```

## dts/bindings/display/hpmicro,hpm-display-rgb.yaml
```yaml
# Copyright 2024 HPMicro
# SPDX-License-Identifier: Apache-2.0

description: HPMicro HPM RGB DISPLAY

compatible: "hpmicro,hpm-display-rgb"

include: ["base.yaml","pinctrl-device.yaml", "hpmicro,hpm-display.yaml"]
```
