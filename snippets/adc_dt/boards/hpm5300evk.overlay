/*
 * Copyright (c) 2026 HPMicro
 * SPDX-License-Identifier: Apache-2.0
 *
 * ADC0 channel 13 (PB05, ADC0.IN13)
 */

/ {
	zephyr,user {
		io-channels = <&adc0 13>;
	};
};

&adc0 {
	status = "okay";
	pinctrl-0 = <&pinmux_adc>;
	pinctrl-names = "default";
	#address-cells = <1>;
	#size-cells = <0>;

	channel@d {
		reg = <13>;
		zephyr,gain = "ADC_GAIN_1";
		zephyr,reference = "ADC_REF_INTERNAL";
		zephyr,acquisition-time = <0>;
		zephyr,resolution = <16>;
	};
};
