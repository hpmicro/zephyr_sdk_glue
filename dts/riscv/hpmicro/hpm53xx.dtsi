/*
 * Copyright 2024 HPMicro
 * SPDX-License-Identifier: Apache-2.0
 */

/dts-v1/;
#include <zephyr/dt-bindings/gpio/gpio.h>
#include <dt-bindings/clock/hpmicro-clocks.h>
#include <mem.h>
#include <freq.h>

/ {
	#address-cells = <1>;
	#size-cells = <1>;

	cpus {
		#address-cells = <1>;
		#size-cells = <0>;
		cpu0: cpu@0 {
			compatible = "andestech,andescore-d25", "riscv"; /* riscv custom */
			reg = <0>;
			status = "okay";
			riscv,isa = "rv32gc_xandes";
			i-cache-line-size = <64>;
			d-cache-line-size = <64>;

			cpu0_intc: interrupt-controller {
				compatible = "riscv,cpu-intc";
				#address-cells = <0>;
				#interrupt-cells = <1>;
				interrupt-controller;
			};
		};
	};

	soc {
		#address-cells = <1>;
		#size-cells = <1>;
		compatible = "hpmicro,hpm53xx";
		ranges;

		clk: clock-controller@f40c0000 {
			compatible = "hpmicro,hpm-pllv2";
			reg = <0xf40c0000 0x4000>;
			clock-frequency = <DT_FREQ_M(960)>;
			reg-names = "clk";
			status = "okay";
		};

		ilm: memory@0 {
			compatible = "zephyr,memory-region";
			reg = <0x0 DT_SIZE_K(128)>;
			zephyr,memory-region = "ITCM";
		};

		dlm: memory@80000 {
			compatible = "zephyr,memory-region";
			reg = <0x080000 DT_SIZE_K(128)>;
			zephyr,memory-region = "DTCM";
		};

		core0_ilm_slv: memory@1040000 {
			reg = <0x1040000 DT_SIZE_K(128)>;
		};

		core0_dlm_slv: memory@1060000 {
			reg = <0x1060000 DT_SIZE_K(128)>;
		};

		plic: interrupt-controller@e4000000 {
			compatible = "sifive,plic-1.0.0";
			#address-cells = <1>;
			#interrupt-cells = <2>;
			interrupt-controller;
			reg = <	0xe4000000 0x00001000
				0xe4002000 0x00000800
				0xe4200000 0x00010000 >;
			reg-names = "prio", "irq_en", "reg";
			riscv,max-priority = <255>;
			riscv,ndev = <1023>;
			interrupts-extended = <&cpu0_intc 0>;
		};

		plic_sw: interrupt-controller@e6400000 {
			compatible = "andestech,plic_sw";
			#address-cells = <1>;
			#interrupt-cells = <2>;
			interrupt-controller;
			reg = <0xe6400000 0x00400000>;
			interrupts-extended = <&cpu0_intc 0>;
		};

		mtimer: machine-timer@e6000000 {
			compatible = "andestech,machine-timer";
			reg = <0xe6000000 0x1
			0xe6000008 0x1>;
			interrupts-extended = <&cpu0_intc 0>;
		};

		fgpio: fgpio@C0000 {
			reg = <0xC0000 0x2000>;
		};

		xpi0: xpi@f3000000 {
			compatible = "hpmicro,xpi";
			reg = <0xf3000000 DT_SIZE_K(16)>;
			#address-cells = <1>;
			#size-cells = <1>;
			status = "disabled";
		};

		gpio0: peripheral@f00d0000 {
			#address-cells = <1>;
			#size-cells = <1>;
			ranges = <0x0 0xf00d0000 DT_SIZE_K(16)>;
		};

		uart0: serial@f0040000 {
			compatible = "hpmicro,hpm-uart";
			reg = <0xf0040000 0x1000>;
			interrupts = <13 1>, <5 1>;
			interrupt-names = "uart", "idletimer";
			clock-name = <19005459>;
			clock-src = <0>;
			interrupt-parent = <&plic>;
			status = "disabled";
		};

		pinctrl: pin-controller@f4040000 {
			compatible = "hpmicro,hpm-pinctrl";
			reg = <0xf4040000 0x4000>;
			status = "okay";
		};

		pinctrl_pioc: pin-controller@f4118000 {
			compatible = "hpmicro,hpm-pinctrl";
			reg = <0xf4118000 0x4000>;
			status = "okay";
		};

		hdma: hdma@f00c8000 {
			#dma-cells = <2>;
			compatible = "hpmicro,hpm-dma";
			dma-channels = <8>;
			dma-requests = <116>;
			reg = <0xf00c8000 0x4000>,
				<0xf00c4000 0x4000>; /* DMAMUX base */
			interrupts = <34 1>;
			interrupt-parent = <&plic>;
			status = "disabled";
		};

		usb0: usb@f300c000 {
			compatible = "hpmicro,hpm-udc";
			clk-name = <CLOCK_USB0>;
			reg = <0xf300c000 0x4000>;
			interrupts = <51 1>;
			interrupt-parent = <&plic>;
			num-bidir-endpoints = <16>;
			status = "disabled";
		;
	};
};

&gpio0 {
	gpioa: gpio@0 {
		compatible = "hpmicro,hpm-gpio";
		reg = <0x0 0x4000>;
		gpio-controller;
		#gpio-cells = <2>;
		hpmicro-gpio-port = <0>;
		interrupts = <1 1>;
		interrupt-parent = <&plic>;
	};

	gpiob: gpio@1 {
		compatible = "hpmicro,hpm-gpio";
		reg = <0x0 0x4000>;
		gpio-controller;
		#gpio-cells = <2>;
		hpmicro-gpio-port = <1>;
		interrupts = <2 1>;
		interrupt-parent = <&plic>;
	};

	gpiox: gpio@2 {
		compatible = "hpmicro,hpm-gpio";
		reg = <0x0 0x4000>;
		gpio-controller;
		#gpio-cells = <2>;
		hpmicro-gpio-port = <13>;
		interrupt-parent = <&plic>;
		interrupts = <3 1>;
		status = "disabled";
	};

	gpioy: gpio@3 {
		compatible = "hpmicro,hpm-gpio";
		reg = <0x0 0x4000>;
		gpio-controller;
		#gpio-cells = <2>;
		hpmicro-gpio-port = <14>;
		interrupts = <4 1>;
		interrupt-parent = <&plic>;
		status = "disabled";
	};
};