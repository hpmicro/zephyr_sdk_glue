/*
* Copyright (c) 2026 HPMicro
* SPDX-License-Identifier: Apache-2.0
*/

#include <dt-bindings/clock/hpm6e80-clocks.h>
#include <hpmicro/HPM6E00/hpm6exx.dtsi>

/ {
	soc {
		compatible = "hpmicro,hpm6e50", "hpmicro,hpm6exx";
	};
};

&sram {
	reg = <0x01200000 DT_SIZE_K(512)>;
};
