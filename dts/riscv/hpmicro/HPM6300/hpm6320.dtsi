/*
* Copyright (c) 2026 HPMicro
* SPDX-License-Identifier: Apache-2.0
*/

#include <dt-bindings/clock/hpm6360-clocks.h>
#include <hpmicro/HPM6300/hpm63xx.dtsi>

/ {
	soc {
		compatible = "hpmicro,hpm6320", "hpmicro,hpm63xx";
		eth0: eth@f2000000 {
			compatible = "hpmicro,hpm-eth";
			clocks = <&clk CLOCK_ETH0 CLK_SRC_PLL0_CLK2 5>;
			reg = <0xf2000000 DT_SIZE_K(16)>;
			interrupts = <62 1>;
			interrupt-parent = <&plic>;
			status = "disabled";
		};

		usb0: usb@f2020000 {
			clk-name = <CLOCK_USB0>;
			reg = <0xf2020000 DT_SIZE_K(16)>;
			interrupts = <61 1>;
			interrupt-parent = <&plic>;
			clocks = <&clk CLOCK_USB0 CLOCK_AXI 1>;
			num-bidir-endpoints = <8>;
			status = "disabled";
		};
	};
};
