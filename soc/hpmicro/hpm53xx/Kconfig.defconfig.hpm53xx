## soc/hpmicro/hpm53xx/Kconfig.defconfig.hpm53xx
```kconfig
# Copyright (c) 2024 HPMicro
# SPDX-License-Identifier: Apache-2.0

if SOC_HPM5301

config SOC
	string
	default "hpm5301"

config SYS_CLOCK_TICKS_PER_SEC
	default 1000

config MAIN_FREQUENCY
	int "SOC 5301 MAIN FREQUENCY(ABOVE 375M)"
	default 48000000

config MAIN_STACK_SIZE
	default 4096

config IDLE_STACK_SIZE
	default 2048

config TEST_EXTRA_STACK_SIZE
	default 2048

endif # SOC_HPM5301

if SOC_HPM5361

config SOC
	string
	default "hpm5361"

config SYS_CLOCK_TICKS_PER_SEC
	default 1000

config MAIN_FREQUENCY
	int "SOC 5361 MAIN FREQUENCY(ABOVE 375M)"
	default 480000000

config MAIN_STACK_SIZE
	default 4096

config IDLE_STACK_SIZE
	default 2048

config TEST_EXTRA_STACK_SIZE
	default 2048

endif # SOC_HPM5361
```

## soc/hpmicro/hpm63xx/Kconfig.series
```kconfig
# Copyright (c) 2024 HPMicro
# SPDX-License-Identifier: Apache-2.0

config SOC_SERIES_HPM63XX
	bool "HPMicro HPM63 Series"
	select RISCV
	select SOC_FAMILY_RISCV_PRIVILEGED
	select SOC_FAMILY_HPM
	select ZEPHYR_HPM_SDK_MODULE
	help
	  Enable support for HPMicro HPM63 series SoC
```

## soc/hpmicro/hpm63xx/Kconfig.soc
```kconfig
# Copyright (c) 2024 HPMicro
# SPDX-License-Identifier: Apache-2.0

choice
	prompt "HPMicro HPM63xx Selection"
	depends on SOC_SERIES_HPM63XX

config SOC_HPM6320
	bool "SOC_HPM6320"
	select ATOMIC_OPERATIONS_BUILTIN
	select INCLUDE_RESET_VECTOR
	select RISCV_ISA_EXT_M
	select RISCV_ISA_EXT_A
    select RISCV_ISA_EXT_C
	select RISCV_ISA_RV32I
	select RISCV_ISA_EXT_ZICSR
	select RISCV_ISA_EXT_ZIFENCEI
	select HAS_HPMSDK_PLLCTLV2
	select HAS_HPMSDK_PMP
	select HAS_HPMSDK_PCFG

config SOC_HPM6340
	bool "SOC_HPM6340"
	select ATOMIC_OPERATIONS_BUILTIN
	select INCLUDE_RESET_VECTOR
	select RISCV_ISA_EXT_M
	select RISCV_ISA_EXT_A
    select RISCV_ISA_EXT_C
	select RISCV_ISA_RV32I
	select RISCV_ISA_EXT_ZICSR
	select RISCV_ISA_EXT_ZIFENCEI
	select HAS_HPMSDK_PLLCTLV2
	select HAS_HPMSDK_PMP
	select HAS_HPMSDK_PCFG

config SOC_HPM6360
	bool "SOC_HPM6360"
	select ATOMIC_OPERATIONS_BUILTIN
	select INCLUDE_RESET_VECTOR
	select RISCV_ISA_EXT_M
	select RISCV_ISA_EXT_A
    select RISCV_ISA_EXT_C
	select RISCV_ISA_RV32I
	select RISCV_ISA_EXT_ZICSR
	select RISCV_ISA_EXT_ZIFENCEI
	select HAS_HPMSDK_PLLCTLV2
	select HAS_HPMSDK_PMP
	select HAS_HPMSDK_PCFG

endchoice


if SOC_SERIES_HPM63XX

config HAS_HPMICRO_CAN
    bool "mcu support castcan"

config HAS_HPMICRO_ADC12
	bool "mcu support adc12"

config HAS_HPMICRO_ADC16
	bool "mcu support adc12"

endif # SOC_SERIES_HPM63XX
```

## soc/hpmicro/hpm67xx/Kconfig
```kconfig
# Copyright (c) 2023-2024 HPMicro
# SPDX-License-Identifier: Apache-2.0

config SOC_SERIES_HPM67XX
	select RISCV
	select RISCV_PRIVILEGED
	select RISCV_HAS_PLIC
	help
	  Enable support for HPMicro HPM64/67 series SoC

config SOC_HPM6750
	bool
	select ATOMIC_OPERATIONS_C
	select INCLUDE_RESET_VECTOR
	select RISCV_ISA_EXT_M
	select RISCV_ISA_EXT_A
    select RISCV_ISA_EXT_C
	select RISCV_ISA_EXT_ZICSR
	select RISCV_ISA_EXT_ZIFENCEI
	select CPU_HAS_DCACHE
	select CPU_HAS_ICACHE

if SOC_SERIES_HPM67XX

choice
	prompt "Base CPU ISA options"
	default HPM67_RV32I

config HPM67_RV32I
	bool "RISCV32 CPU ISA"
	select RISCV_ISA_RV32I

config HPM67_RV32E
	bool "RISCV32E CPU ISA"
	select RISCV_ISA_RV32E

endchoice

choice
	prompt "FPU options"
	default HPM67_NO_FPU

config HPM67_NO_FPU
	bool "No FPU"

config HPM67_SINGLE_PRECISION_FPU
	bool "Single precision FPU"
	select CPU_HAS_FPU

config HPM67_DOUBLE_PRECISION_FPU
	bool "Double precision FPU"
	select CPU_HAS_FPU_DOUBLE_PRECISION

endchoice

config SOC_ANDES_V5_HWDSP
	bool "AndeStar V5 DSP ISA"
	select RISCV_SOC_CONTEXT_SAVE
	depends on !RISCV_GENERIC_TOOLCHAIN
	help
		This option enables the AndeStar v5 hardware DSP, in order to
		support using the DSP instructions.

config SOC_ANDES_V5_PMA
	bool "Andes V5 Physical Memory Attribute (PMA)"
	default y
	select ARCH_HAS_NOCACHE_MEMORY_SUPPORT
	help
		This option enables the Andes V5 PMA, in order to support SW to
		configure physical memory attribute by PMA CSRs. The address
		matching of Andes V5 PMA is like RISC-V PMP NAPOT mode
		(power-of-two alignment).

endif # SOC_SERIES_HPM67XX
```

## soc/hpmicro/hpm67xx/Kconfig.defconfig.hpm6750
```kconfig
# Copyright (c) 2023-2024 HPMicro
# SPDX-License-Identifier: Apache-2.0

if SOC_HPM6750

config SYS_CLOCK_TICKS_PER_SEC
	default 1000

config MAIN_FREQUENCY
	int "SOC 6750 MAIN FREQUENCY(ABOVE 375M)"
	default 648000000

config ISR_STACK_SIZE
	default 2048

config MAIN_STACK_SIZE
	default 4096

config IDLE_STACK_SIZE
	default 2048

config PRIVILEGED_STACK_SIZE
	default 2048

config TEST_EXTRA_STACK_SIZE
	default 8192

endif # SOC_HPM6750
```

## soc/hpmicro/hpm67xx/Kconfig.soc
```kconfig
# Copyright (c) 2023-2024 HPMicro
# SPDX-License-Identifier: Apache-2.0
config SOC_SERIES_HPM67XX
	bool "HPMicro HPM64/67 Series"
	select SOC_FAMILY_HPM
	select HAS_HPMSDK_PLLCTL
	select HAS_HPMSDK_PMP
	select HAS_HPMSDK_PCFG
	help
	  Enable support for HPMicro HPM68 series SoC

config SOC_SERIES
	default "hpm67xx" if SOC_SERIES_HPM67XX

config SOC_HPM6750
	bool
	select SOC_SERIES_HPM67XX

config SOC
	default "hpm6750" if SOC_HPM6750
```

## soc/hpmicro/hpm68xx/Kconfig
```kconfig
# Copyright (c) 2024 HPMicro
# SPDX-License-Identifier: Apache-2.0

config SOC_SERIES_HPM68XX
	select RISCV
	select RISCV_PRIVILEGED
	select RISCV_HAS_PLIC
	select DYNAMIC_INTERRUPTS
	help
	  Enable support for HPMicro HPM68 series SoC

config SOC_HPM6830
	bool
	select ATOMIC_OPERATIONS_BUILTIN
	select INCLUDE_RESET_VECTOR
	select RISCV_ISA_EXT_M
	select RISCV_ISA_EXT_A
    select RISCV_ISA_EXT_C
	select RISCV_ISA_EXT_ZICSR
	select RISCV_ISA_EXT_ZIFENCEI
	select CPU_HAS_DCACHE
	select CPU_HAS_ICACHE
	# select RISCV_PMP

config SOC_HPM6850
	bool
	select ATOMIC_OPERATIONS_BUILTIN
	select INCLUDE_RESET_VECTOR
	select RISCV_ISA_EXT_M
	select RISCV_ISA_EXT_A
    select RISCV_ISA_EXT_C
	select RISCV_ISA_EXT_ZICSR
	select RISCV_ISA_EXT_ZIFENCEI
	select CPU_HAS_DCACHE
	select CPU_HAS_ICACHE
	# select RISCV_PMP

config SOC_HPM6880
	bool
	select ATOMIC_OPERATIONS_BUILTIN
	select INCLUDE_RESET_VECTOR
	select RISCV_ISA_EXT_M
	select RISCV_ISA_EXT_A
    select RISCV_ISA_EXT_C
	select RISCV_ISA_EXT_ZICSR
	select RISCV_ISA_EXT_ZIFENCEI
	select CPU_HAS_DCACHE
	select CPU_HAS_ICACHE
	# select RISCV_PMP

if SOC_SERIES_HPM68XX

choice
	prompt "Base CPU ISA options"
	default HPM68_RV32I

config HPM68_RV32I
	bool "RISCV32 CPU ISA"
	select RISCV_ISA_RV32I

config HPM68_RV32E
	bool "RISCV32E CPU ISA"
	select RISCV_ISA_RV32E

endchoice

choice
	prompt "FPU options"
	default HPM68_NO_FPU

config HPM68_NO_FPU
	bool "No FPU"

config HPM68_SINGLE_PRECISION_FPU
	bool "Single precision FPU"
	select CPU_HAS_FPU

config HPM68_DOUBLE_PRECISION_FPU
	bool "Double precision FPU"
	select CPU_HAS_FPU_DOUBLE_PRECISION

endchoice

config SOC_ANDES_V5_HWDSP
	bool "AndeStar V5 DSP ISA"
	select RISCV_SOC_CONTEXT_SAVE
	depends on !RISCV_GENERIC_TOOLCHAIN
	help
		This option enables the AndeStar v5 hardware DSP, in order to
		support using the DSP instructions.

config SOC_ANDES_V5_PMA
	bool "Andes V5 Physical Memory Attribute (PMA)"
	default y
	select ARCH_HAS_NOCACHE_MEMORY_SUPPORT
	help
		This option enables the Andes V5 PMA, in order to support SW to
		configure physical memory attribute by PMA CSRs. The address
		matching of Andes V5 PMA is like RISC-V PMP NAPOT mode
		(power-of-two alignment).

endif # SOC_SERIES_HPM68XX
```

## soc/hpmicro/hpm68xx/Kconfig.defconfig.hpm6880
```kconfig
# Copyright (c) 2024 HPMicro
# SPDX-License-Identifier: Apache-2.0

if SOC_HPM6880

config SYS_CLOCK_TICKS_PER_SEC
	default 1000

config MAIN_FREQUENCY
	int "SOC 6880 MAIN FREQUENCY(ABOVE 384M)"
	default $(dt_node_int_prop_int,$(dt_nodelabel_path,clk),clock-frequency)

config ISR_STACK_SIZE
	default 2048

config MAIN_STACK_SIZE
	default 8192

config IDLE_STACK_SIZE
	default 2048

# config PRIVILEGED_STACK_SIZE
# 	default 2048

config TEST_EXTRA_STACK_SIZE
	default 8192

endif # SOC_HPM6880
```

## soc/hpmicro/hpm68xx/Kconfig.series
```kconfig
# Copyright (c) 2024 HPMicro
# SPDX-License-Identifier: Apache-2.0

config SOC_SERIES_HPM68XX
	bool "HPMicro HPM68 Series"
	select RISCV
	select SOC_FAMILY_RISCV_PRIVILEGED
	select SOC_FAMILY_HPM
	select ZEPHYR_HPM_SDK_MODULE
	help
	  Enable support for HPMicro HPM68 series SoC
```

## soc/hpmicro/hpm68xx/Kconfig.soc
```kconfig
# Copyright (c) 2024 HPMicro
# SPDX-License-Identifier: Apache-2.0
config SOC_SERIES_HPM68XX
	bool "HPMicro HPM68 Series"
	select SOC_FAMILY_HPM
	select HAS_HPMSDK_PLLCTLV2
	select HAS_HPMSDK_PMP
	select HAS_HPMSDK_PCFG
	help
	  Enable support for HPMicro HPM68 series SoC

config SOC_SERIES
	default "hpm68xx" if SOC_SERIES_HPM68XX

config SOC_HPM6830
	bool
	select SOC_SERIES_HPM68XX

config SOC_HPM6850
	bool
	select SOC_SERIES_HPM68XX

config SOC_HPM6880
	bool
	select SOC_SERIES_HPM68XX

config SOC
	default "hpm6830" if SOC_HPM6830
	default "hpm6850" if SOC_HPM6850
	default "hpm6880" if SOC_HPM6880
```

## soc/riscv/hpmicro/Kconfig
```kconfig
# Configuration options for hpmicro riscv SOCs supporting the riscv privileged
# architecture specification

# Copyright (c) 2024 HPMicro
# SPDX-License-Identifier: Apache-2.0

config SOC_FAMILY_RISCV_PRIVILEGED
	bool

config SOC_FAMILY_HPM
	bool

if SOC_FAMILY_HPM

config SOC_FAMILY
	string
	default "hpmicro"
	depends on SOC_FAMILY_RISCV_PRIVILEGED

config SOC_ANDES_V5_HWDSP
	bool "AndeStar V5 DSP ISA"
	select RISCV_SOC_CONTEXT_SAVE
	depends on !RISCV_GENERIC_TOOLCHAIN
	help
		This option enables the AndeStar v5 hardware DSP, in order to
		support using the DSP instructions.
	
source "${ZEPHYR_SDK_GLUE_MODULE_DIR}/soc/riscv/hpmicro/*/Kconfig.soc"

endif # SOC_FAMILY_HPM
```

## soc/riscv/hpmicro/Kconfig.defconfig
```kconfig
# Configuration options for hpmicro riscv SOCs supporting the riscv privileged
# architecture specification

# Copyright (c) 2024 HPMicro
# SPDX-License-Identifier: Apache-2.0

# default value between 40 to 60, after plic init, before console init
config SERIAL_INIT_PRIORITY
    default KERNEL_INIT_PRIORITY_DEVICE
    depends on SERIAL

source "${ZEPHYR_SDK_GLUE_MODULE_DIR}/soc/riscv/hpmicro/*/Kconfig.defconfig.series"
```

## soc/riscv/hpmicro/Kconfig.soc
```kconfig
# Copyright (c) 2023 HPMicro
# SPDX-License-Identifier: Apache-2.0

source "${ZEPHYR_SDK_GLUE_MODULE_DIR}/soc/riscv/hpmicro/*/Kconfig.series"
```

## soc/riscv/hpmicro/hpm53xx/Kconfig.defconfig.series
```kconfig
# Copyright (c) 2024 HPMicro
# SPDX-License-Identifier: Apache-2.0

if SOC_SERIES_HPM53XX

config SOC_SERIES
	default "hpm53xx"

config SYS_CLOCK_HW_CYCLES_PER_SEC
	default 24000000

config KERNEL_ENTRY
	default "_start"

config RISCV_GENERIC_TOOLCHAIN
	default y if "$(ZEPHYR_TOOLCHAIN_VARIANT)" = "zephyr"
	default n

config RISCV_SOC_INTERRUPT_INIT
	default y

config RISCV_HAS_CPU_IDLE
	default y

config RISCV_HAS_PLIC
	default y

config RISCV_GP
	default y

config MAX_IRQ_PER_AGGREGATOR
	default 112

config NUM_IRQS
	default 128

source "${ZEPHYR_SDK_GLUE_MODULE_DIR}/soc/riscv/hpmicro/hpm53xx/Kconfig.defconfig.hpm5*"

endif # SOC_SERIES_HPM53XX
```

## soc/riscv/hpmicro/hpm53xx/Kconfig.series
```kconfig
# Copyright (c) 2024 HPMicro
# SPDX-License-Identifier: Apache-2.0

config SOC_SERIES_HPM53XX
	bool "HPMicro HPM53 Series"
	select RISCV
	select SOC_FAMILY_RISCV_PRIVILEGED
	select SOC_FAMILY_HPM
	select ZEPHYR_HPM_SDK_MODULE
	help
	  Enable support for HPMicro HPM53 series SoC
```

## soc/riscv/hpmicro/hpm53xx/Kconfig.soc
```kconfig
# Copyright (c) 2024 HPMicro
# SPDX-License-Identifier: Apache-2.0

choice
	prompt "HPMicro HPM53xx Selection"
	depends on SOC_SERIES_HPM53XX

config SOC_HPM5301
	bool "SOC_HPM5301"
	select ATOMIC_OPERATIONS_BUILTIN
	select INCLUDE_RESET_VECTOR
	select RISCV_ISA_EXT_M
	select RISCV_ISA_EXT_A
    select RISCV_ISA_EXT_C
	select RISCV_ISA_RV32I
	select RISCV_ISA_EXT_ZICSR
	select RISCV_ISA_EXT_ZIFENCEI
	select HAS_HPMSDK_PLLCTLV2
	select HAS_HPMSDK_PMP
	select HAS_HPMSDK_PCFG

config SOC_HPM5361
	bool "SOC_HPM5361"
	select ATOMIC_OPERATIONS_BUILTIN
	select INCLUDE_RESET_VECTOR
	select RISCV_ISA_EXT_M
	select RISCV_ISA_EXT_A
    select RISCV_ISA_EXT_C
	select RISCV_ISA_RV32I
	select RISCV_ISA_EXT_ZICSR
	select RISCV_ISA_EXT_ZIFENCEI
	select HAS_HPMSDK_PLLCTLV2
	select HAS_HPMSDK_PMP
	select HAS_HPMSDK_PCFG

endchoice


if SOC_SERIES_HPM53XX

config HAS_HPMICRO_CAN
    bool "mcu support castcan"

config HAS_HPMICRO_ADC12
	bool "mcu support adc12"

config HAS_HPMICRO_ADC16
	bool "mcu support adc12"

endif # SOC_SERIES_HPM53XX
```

## soc/riscv/hpmicro/hpm5xxx/Kconfig.defconfig.hpm5361
```kconfig
# Copyright (c) 2023 HPMicro
# SPDX-License-Identifier: Apache-2.0

if SOC_HPM5361

config SOC
	string
	default "hpm5361"

config SYS_CLOCK_TICKS_PER_SEC
	default 1000

config MAIN_STACK_SIZE
	default 4096

config IDLE_STACK_SIZE
	default 2048

config TEST_EXTRA_STACK_SIZE
	default 2048

endif # HPM5361
```

## soc/riscv/hpmicro/hpm5xxx/Kconfig.series
```kconfig
# Copyright (c) 2023 HPMicro
# SPDX-License-Identifier: Apache-2.0

config SOC_SERIES_HPM5XXX
	bool "HPMicro HPM5300 Series"
	select RISCV
	select SOC_FAMILY_RISCV_PRIVILEGED
	select SOC_FAMILY_HPM
	select ZEPHYR_HPM_SDK_MODULE
	help
	  Enable support for HPMicro HPM5300 series SoC
```

## soc/riscv/hpmicro/hpm5xxx/Kconfig.soc
```kconfig
# Copyright (c) 2023 HPMicro
# SPDX-License-Identifier: Apache-2.0


choice
	prompt "HPMicro HPM5xxx Selection"
	depends on SOC_SERIES_HPM5XXX

config SOC_HPM5361
	bool "SOC_HPM5361"
	select ATOMIC_OPERATIONS_BUILTIN
	select INCLUDE_RESET_VECTOR
	select RISCV_ISA_EXT_M
	select RISCV_ISA_EXT_A
    select RISCV_ISA_EXT_C
	select RISCV_ISA_RV32I
	select RISCV_ISA_EXT_ZICSR
	select RISCV_ISA_EXT_ZIFENCEI
	select HAS_HPMSDK_PDM
	select HAS_HPMSDK_PLLCTL
	select HAS_HPMSDK_PMP
	select HAS_HPMSDK_PCFG	
	select HAS_HPMICRO_ADC12
	select HAS_HPMICRO_ADC16
    select HAS_HPMICRO_CAN

endchoice

if SOC_SERIES_HPM5XXX

config HAS_HPMICRO_CAN
    bool "mcu support castcan"

config HAS_HPMICRO_ADC12
	bool "mcu support adc12"

config HAS_HPMICRO_ADC16
	bool "mcu support adc12"

endif # SOC_SERIES_HPM5XXX
```

## soc/riscv/hpmicro/hpm63xx/Kconfig.defconfig.hpm63xx
```kconfig
# Copyright (c) 2023-2024 HPMicro
# SPDX-License-Identifier: Apache-2.0

if SOC_HPM6320
config SOC
	string
	default "hpm6320"

config SYS_CLOCK_TICKS_PER_SEC
	default 1000

config MAIN_FREQUENCY
	int "SOC 6320 MAIN FREQUENCY(ABOVE 375M)"
	default 576000000

config MAIN_STACK_SIZE
	default 4096

config IDLE_STACK_SIZE
	default 2048

config TEST_EXTRA_STACK_SIZE
	default 2048

endif # HPM6320

if SOC_HPM6340
config SOC
	string
	default "hpm6340"

config SYS_CLOCK_TICKS_PER_SEC
	default 1000

config MAIN_FREQUENCY
	int "SOC 6340 MAIN FREQUENCY(ABOVE 375M)"
	default 576000000

config MAIN_STACK_SIZE
	default 4096

config IDLE_STACK_SIZE
	default 2048

config TEST_EXTRA_STACK_SIZE
	default 2048

endif # HPM6340

if SOC_HPM6360
config SOC
	string
	default "hpm6360"

config SYS_CLOCK_TICKS_PER_SEC
	default 1000

config MAIN_FREQUENCY
	int "SOC 6360 MAIN FREQUENCY(ABOVE 375M)"
	default 576000000

config MAIN_STACK_SIZE
	default 4096

config IDLE_STACK_SIZE
	default 2048

config TEST_EXTRA_STACK_SIZE
	default 2048

endif # HPM6360
```

## soc/riscv/hpmicro/hpm63xx/Kconfig.defconfig.series
```kconfig
# Copyright (c) 2024 HPMicro
# SPDX-License-Identifier: Apache-2.0

if SOC_SERIES_HPM63XX

config SOC_SERIES
	default "hpm63xx"

config SYS_CLOCK_HW_CYCLES_PER_SEC
	default 24000000

config KERNEL_ENTRY
	default "_start"

config RISCV_GENERIC_TOOLCHAIN
	default y if "$(ZEPHYR_TOOLCHAIN_VARIANT)" = "zephyr"
	default n

config RISCV_SOC_INTERRUPT_INIT
	default y

config RISCV_HAS_CPU_IDLE
	default y

config RISCV_HAS_PLIC
	default y

config RISCV_GP
	default y

config MAX_IRQ_PER_AGGREGATOR
	default 112

config NUM_IRQS
	default 128

source "${ZEPHYR_SDK_GLUE_MODULE_DIR}/soc/riscv/hpmicro/hpm63xx/Kconfig.defconfig.hpm6*"

endif # SOC_SERIES_HPM63XX
```
