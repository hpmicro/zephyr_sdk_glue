## snippets/video_dvp/boards/hpm6750evk2.conf
```kconfig
CONFIG_HEAP_MEM_POOL_SIZE=8388608
CONFIG_DISPLAY_HPMICRO=y
CONFIG_LOG=y
CONFIG_LOG_BUFFER_SIZE=8192
CONFIG_DISPLAY_LOG_LEVEL_DBG=y
CONFIG_VIDEO_OV7725_DEFAULT_WIDTH=640
CONFIG_VIDEO_OV7725_DEFAULT_HEIGHT=480
CONFIG_VIDEO_OV7725_DEFAULT_PITCH=1280
```

## snippets/video_dvp/boards/hpm6800evk.conf
```kconfig
CONFIG_VIDEO_BUFFER_POOL_SZ_MAX=24576000
CONFIG_VIDEO_BUFFER_POOL_NUM_MAX=8
CONFIG_HEAP_MEM_POOL_SIZE=33554432
CONFIG_DISPLAY_HPMICRO=y
CONFIG_LOG=y
CONFIG_LOG_BUFFER_SIZE=8192
CONFIG_DISPLAY_LOG_LEVEL_DBG=y
```

## snippets/video_mipi/boards/hpm6800evk.conf
```kconfig
CONFIG_VIDEO_BUFFER_POOL_SZ_MAX=24576000
CONFIG_VIDEO_BUFFER_POOL_NUM_MAX=8
CONFIG_HEAP_MEM_POOL_SIZE=33554432
CONFIG_DISPLAY_HPMICRO=y
CONFIG_LOG=y
CONFIG_LOG_BUFFER_SIZE=8192
CONFIG_NO_OPTIMIZATIONS=y
CONFIG_SHELL_STACK_SIZE=8192
CONFIG_SHELL_PRINTF_BUFF_SIZE=100
CONFIG_VIDEO_BUFFER_POOL_NUM_MAX=6
CONFIG_ADC_SHELL=n
CONFIG_DISPLAY_LOG_LEVEL_DBG=y
CONFIG_VIDEO_OV5640_DEFAULT_WIDTH=640
CONFIG_VIDEO_OV5640_DEFAULT_HEIGHT=480
CONFIG_VIDEO_OV5640_DEFAULT_PITCH=1280
```

## soc/hpmicro/HPM6800/Kconfig.defconfig.hpm6830
```kconfig
# Copyright (c) 2024 HPMicro
# SPDX-License-Identifier: Apache-2.0

if SOC_HPM6830

config SYS_CLOCK_TICKS_PER_SEC
	default 1000

config MAIN_STACK_SIZE
	default 4096

config IDLE_STACK_SIZE
	default 2048

config PRIVILEGED_STACK_SIZE
	default 2048

config TEST_EXTRA_STACK_SIZE
	default 8192

endif # SOC_HPM6830
```

## soc/hpmicro/HPM6800/Kconfig.soc
```kconfig
# Copyright (c) 2024 HPMicro
# SPDX-License-Identifier: Apache-2.0
config SOC_SERIES_HPM6800
	bool
	select SOC_FAMILY_HPM
	select HAS_HPMSDK_PLLCTLV2
	select HAS_HPMSDK_PCFG
	help
	  Enable support for HPMicro HPM68 series SoC

config SOC_SERIES
	default "HPM6800" if SOC_SERIES_HPM6800

config SOC_HPM6830
	bool
	select SOC_SERIES_HPM6800

config SOC_HPM6850
	bool
	select SOC_SERIES_HPM6800

config SOC_HPM6880
	bool
	select SOC_SERIES_HPM6800

config SOC
	default "HPM6830" if SOC_HPM6830
	default "HPM6850" if SOC_HPM6850
	default "HPM6880" if SOC_HPM6880
```

## soc/hpmicro/Kconfig.defconfig
```kconfig
# Configuration options for hpmicro riscv SOCs supporting the riscv privileged
# architecture specification

# Copyright (c) 2024 HPMicro
# SPDX-License-Identifier: Apache-2.0

# default value between 40 to 60, after plic init, before console init
if SOC_FAMILY_HPM

rsource "${ZEPHYR_SDK_GLUE_MODULE_DIR}/soc/hpmicro/*/Kconfig.defconfig.series"

config SERIAL_INIT_PRIORITY
    default KERNEL_INIT_PRIORITY_DEVICE
    depends on SERIAL

config PINCTRL
    default y

config CLOCK_CONTROL
    default y

endif
```

## soc/hpmicro/Kconfig.soc
```kconfig
# Copyright (c) 2024 HPMicro
# SPDX-License-Identifier: Apache-2.0

config SOC_FAMILY_HPM
    bool

config SOC_FAMILY
    default "hpmicro" if SOC_FAMILY_HPM

source "${ZEPHYR_SDK_GLUE_MODULE_DIR}/soc/hpmicro/*/Kconfig.soc"
```
