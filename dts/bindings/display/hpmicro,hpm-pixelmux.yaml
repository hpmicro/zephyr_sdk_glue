## dts/bindings/display/hpmicro,hpm-pixelmux.yaml
```yaml
# Copyright 2024 HPMicro
# SPDX-License-Identifier: Apache-2.0

description: HPMicro HPM PIXELMUX

compatible: "hpmicro,hpm-pixelmux"

include: ["base.yaml"]


  
```

## dts/bindings/display/hpmicro,hpm-rgb.yaml
```yaml
# Copyright 2024 HPMicro
# SPDX-License-Identifier: Apache-2.0

description: HPMicro HPM RGB

compatible: "hpmicro,hpm-rgb"

include: ["base.yaml"]

properties:
  endpoint_in:
      type: phandle
      required: true
      description: video data source of the rgb
  test:
      type: int
```

## dts/bindings/dma/hpmicro,hpm-dmav2.yaml
```yaml
# Copyright 2024 HPMicro
# SPDX-License-Identifier: Apache-2.0

description: HPMicro DMA(hdma/xdma) controller

compatible: "hpmicro,hpm-dmav2"

include: dma-controller.yaml

properties:
    reg:
      required: true

    interrupts:
      required: true

    dma-channels:
      required: true

    dma-requests:
      required: true

    "#dma-cells":
      type: int
      required: true
      description: Number of items to expect in a DMAMUX specifier


#- #dma-cells : Must be <2>.
#  The 1st cell specifies the channel.
#    Specific request source can only be multiplexed by specific channels
#  The 2nd cell specifies the request source(slot) ID.
#    See the SoC's reference manual for all the supported request sources.

dma-cells:
  - channel
  - source
```

## dts/bindings/eth/hpmicro,hpm-eth.yaml
```yaml
# Copyright 2025 HPMicro
# SPDX-License-Identifier: Apache-2.0

description: HPMicro HPM Ethernet

compatible: "hpmicro,hpm-eth"

include: [ethernet-controller.yaml, pinctrl-device.yaml]

properties:
  reg:
    required: true

  interrupts:
    required: true

  clocks:
    required: true

  pinctrl-0:
    required: true

  pinctrl-names:
    required: true

  reset-gpios:
    required: false
    type: phandle-array
```

## dts/bindings/i2c/hpmicro,hpm-i2c.yaml
```yaml
# Copyright 2024 HPMicro
# SPDX-License-Identifier: Apache-2.0

description: HPMicro HPM I2C

compatible: "hpmicro,hpm-i2c"

include: [i2c-controller.yaml, pinctrl-device.yaml]

properties:
  reg:
    required: true

  interrupts:
    required: true

  clocks:
    required: true

  pinctrl-0:
    required: true

  pinctrl-names:
    required: true
```

## dts/bindings/pinctrl/hpmicro,hpm-pinctrl.yaml
```yaml
# Copyright 2022-2025 HPMicro
# SPDX-License-Identifier: Apache-2.0

description: |
  The HPMicro pin controller is a singleton node responsible for
  controlling pin function selection and pin properties. For example, you can
  use this node to route UART0 RX to pin PA10 and enable the pull-up resistor
  on the pin. Remapping is also supported.

  The node has the 'pinctrl' node label set in your SoC's devicetree,
  so you can modify it like this:

    &pinctrl {
            /* your modifications go here */
    };

  All device pin configurations should be placed in child nodes of the
  'pinctrl' node, as shown in this example:

  &pinctrl {
    pinmux_uart0: pinmux_uart0 {
      group0 {
        pinmux = <HPMICRO_PINMUX(HPMICRO_PIN(HPMICRO_PORTY, 7),IOC_TYPE_IOC, 0, 2)>,
        <HPMICRO_PINMUX(HPMICRO_PIN(HPMICRO_PORTY, 6),IOC_TYPE_IOC, 0, 2)>;
      };
    };
    pinmux_gpiob: pinmux_gpiob {
      group0 {
        pinmux = <HPMICRO_PINMUX(HPMICRO_PIN(HPMICRO_PORTB, 18),IOC_TYPE_IOC, 0, 0)>,
            <HPMICRO_PINMUX(HPMICRO_PIN(HPMICRO_PORTB, 19),IOC_TYPE_IOC, 0, 0)>,
            <HPMICRO_PINMUX(HPMICRO_PIN(HPMICRO_PORTB, 20),IOC_TYPE_IOC, 0, 0)>;
            bias-pull-down;
      };
    };
  };

  A group can also specify shared pin properties common to all the specified
  pins, such as the 'bias-pull-up' property in group 2. Here is a list of
  supported standard pin properties:

  - drive-open-drain: Open-drain drive mode.
  - bias-disable: Disable pull-up/down (default, not required).
  - bias-pull-up: Enable pull-up resistor.
  - bias-pull-down: Enable pull-down resistor.
  - input-enable: enable input.
  - input-schmitt-enable: enable input schmitt circuit.

  The macro HPMICRO_PINMUX sets the pinmux function:
  - The first parameter is the pin number, the macro HPMICRO_PIN generates pin numbers.
  - The second parameter enables to indicate that the pin is an analogue pin.
  - The third parameter is the remapping number,
    look up the datasheet to obtain the parameters.

compatible: "hpmicro,hpm-pinctrl"

include:
  - name: base.yaml
  - name: pincfg-node-group.yaml
    child-binding:
      child-binding:
        property-allowlist:
          - drive-open-drain
          - input-enable
          - bias-disable
          - bias-pull-down
          - bias-pull-up
          - input-schmitt-enable
          - keeper-capability-disable

child-binding:
  description: HPMicro pin controller pin group
  child-binding:
    description: |
      HPMicro pin controller pin configuration node.
    properties:
      pinmux:
        required: true
        type: array
        description: |
          Represents pin mux settings. Use HPMICRO_PINMUX
          With:
          - pin: The gpio pin number (0, 1, ..., GPIO_NUM_MAX)
          - analog: bool, select analog pin in pad
          - alt_select: alt0-alt31
          - ioc: IOC_TYPE_IOC IOC_TYPE_BIOC IOC_TYPE_PIOC
      drive-strength:
        required: false
        type: string
        default: "r000"
        enum:
          - "r000"
          - "r001"
          - "r010"
          - "r011"
          - "r100"
          - "r101"
          - "r110"
          - "r111"
      power-source:
        required: false
        type: string
        default: "3v3"
        enum:
          - "3v3"
          - "1v8"
      slew-pd:
        required: false
        type: string
        default: "50M"
        enum:
          - "50M"
          - "100M"
          - "150M"
          - "200M"
      pull-resistance-strength:
        required: false
        type: string
        default: "100KOhm"
        enum:
          - "100KOhm"
          - "47KOhm"
          - "22KOhm"
      slew-rate:
        required: false
        type: string
        default: "slow"
        enum:
          - "slow"
          - "fast"

      keeper-capability-disable:
        required: false
        type: boolean
        description: disable keeper capability, KE enabled by default
```

## dts/bindings/pwm/hpmicro,hpm-pwm.yaml
```yaml
# Copyright 2022 hpmicro
# SPDX-License-Identifier: Apache-2.0

description: HPMICRO PWM Module

compatible: "hpmicro,hpm-pwm"

include: [pwm-controller.yaml, base.yaml, pinctrl-device.yaml]

properties:
    reg:
      required: true

    pinctrl-0:
      required: true
    
    clock-name:
      type: int
      description: pwm clock name
      required: true

    period-init:
      type: int
      description: pwm period, unit hz
      required: true
    
    dead-zone-in-half-cycle:
      type: int
      description: pwm dead zone in half cycle, unit cycle
      required: true

    en-pwm-trig:
      type: boolean
      description: Enable PWM trigger mode
      required: false

    "#pwm-cells":
      const: 3

pwm-cells:
  - channel
  - period
  - flags
```

## dts/bindings/sdhc/hpmicro,hpm-sdhc.yaml
```yaml
# Copyright 2024 HPMicro
# SPDX-License-Identifier: Apache-2.0

description: HPMicro HPM SDHC

compatible: "hpmicro,hpm-sdhc"

include: [sdhc.yaml, pinctrl-device.yaml]

properties:
  reg:
    required: true

  interrupts:
    required: true

  clk-name:
    type: int
    required: true
    description: SDHC clock name

  clk-source:
    type: int
    required: true
    description: SDHC clock source

  clk-divider:
    type: int
    required: true
    description: SDHC clock divider

  pwr-gpios:
    type: phandle-array
    description: |
      Power pin
      This pin defaults to active high when consumed by the SD card. The
      property value should ensure the flags properly describe the signal
      that is presented to the driver.

  cd-gpios:
    type: phandle-array
    description: |
      Detect pin
      This pin defaults to active low when produced by the SD card. The
      property value should ensure the flags properly describe the signal
      that is presented to the driver.

  embedded-4-bit-support:
    type: boolean
    description: |
      The host controller supports 4bit width mode

  pwr-3v3-support:
    type: boolean
    description: |
      3.3v support

  pwr-3v0-support:
    type: boolean
    description: |
      3.0v support

  pwr-1v8-support:
    type: boolean
    description: |
      1.8v support
```

## dts/bindings/serial/hpmicro,hpm-uart.yaml
```yaml
# Copyright 2022 HPMicro
# SPDX-License-Identifier: Apache-2.0

description: HPMicro UART

compatible: "hpmicro,hpm-uart"

include: [uart-controller.yaml, pinctrl-device.yaml]

properties:
    reg:
      required: true

    interrupts:
      required: true

    clocks:
      required: true

    uart-idle-trgm-reg:
      required: false
      type: int
      description: Uart idle trgm base addr
    
    uart-idle-trgm-pin:
      type: int
      description: Uart idle trgm pin
    
    uart-idle-trgm-input-src:
      type: int
      description: Uart idle trgm inut source
    
    uart-idle-trgm-output-gptmr-in:
      type: int
      description: Uart idle trgm output to gptmr
    
    uart-idle-trgm-output-gptmr-sync:
      type: int
      description: Uart idle trgm output to gptmr sync
    
    uart-idle-gptmr-reg:
      type: int
      description: Uart idle gptmr base addr

    uart-idle-gptmr-clock-name:
      type: int
      description: Uart idle gptmr clock name

    dmas:
      description: |
        Optional TX & RX dma specifiers.  Each specifier will have a phandle
        reference to the dmac controller, the channel number, and peripheral
        trigger source.

    dma-names:
      description: |
        Required if the dmas property exists.  This should be "tx" and "rx"
        to match the dmas property.
    
    loopback:
      type: boolean
      description: |
        Enable loopback mode on LPUART peripheral. When present, RX pin is
        disconnected, and transmitter output is internally connected to
        the receiver input.
```

## dts/bindings/spi/hpmicro,hpm-spi.yaml
```yaml
# Copyright 2022 hpmicro
# SPDX-License-Identifier: Apache-2.0

description: HPMicro controller

compatible: "hpmicro,hpm-spi"

include: ["spi-controller.yaml", "pinctrl-device.yaml"]

properties:
    reg:
      required: true

    interrupts:
      required: true

    pinctrl-0:
      type: phandles
      required: true

    cs-sck-delay:
      type: int
      required: false
      description: |
        the minimum time from the chip select assert to the first clock
        edge. If not set, the minimum supported delay is used.
        0 - 1/2 SCK period; 1 - 2/2 SCK period;
        2 - 3/2 SCK period; 3 - 4/2 SCK period;

    cs-minimum-high-time:
      type: int
      required: false
      description: |
        The minimum time that SPI CS should stay HIGH.
        ( SCK period / 2 ) * ( x + 1)

    dmas:
      description: |
        Optional TX & RX dma specifiers.  Each specifier will have a phandle
        reference to the dmac controller, the channel number, and peripheral
        trigger source.

        For example dmas for TX, RX on SERCOM3
           dmas = <&dmac 0 0xb>, <&dmac 1 0xa>;

    dma-names:
      description: |
        Required if the dmas property exists.  This should be "tx" and "rx"
        to match the dmas property.

        For example
           dma-names = "tx", "rx";
```

## dts/bindings/usb/hpmicro,hpm-cherryusb-device.yaml
```yaml
# Copyright 2025 hpmicro
# SPDX-License-Identifier: Apache-2.0

description: HPMICRO CHERRYUSB device controller

compatible: "hpmicro,hpm-cherryusb-device"

include: ["usb-ep.yaml", "pinctrl-device.yaml"]

properties:
  reg:
    required: true

  interrupts:
    required: true

  clk-name:
    type: int
    required: true
    description: USB clock name
```

## dts/bindings/usb/hpmicro,hpm-cherryusb-host.yaml
```yaml
# Copyright 2025 hpmicro
# SPDX-License-Identifier: Apache-2.0

description: HPMICRO CHERRYUSB host controller

compatible: "hpmicro,hpm-cherryusb-host"

include: ["usb-ep.yaml", "pinctrl-device.yaml"]

properties:
  reg:
    required: true

  interrupts:
    required: true

  clk-name:
    type: int
    required: true
    description: USB clock name
```

## dts/bindings/usb/hpmicro,hpm-cherryusb.yaml
```yaml
# Copyright 2025 hpmicro
# SPDX-License-Identifier: Apache-2.0

description: HPMicro CherryUSB Controller

compatible: "hpmicro,hpm-cherryusb"

include: ["usb-ep.yaml", "pinctrl-device.yaml"]

properties:
  reg:
    required: true

  interrupts:
    required: true

  clk-name:
    type: int
    required: true
    description: USB clock name
```

## dts/bindings/video/hpmicro,hpm-camera.yaml
```yaml
# Copyright 2024 HPMicro
# SPDX-License-Identifier: Apache-2.0

description: HPMicro HPM CAMERA

compatible: "hpmicro,hpm-camera"

include: [base.yaml, pinctrl-device.yaml]

properties:
  reg:
    required: true

  interrupts:
    required: true

  clocks:
    required: true

  pinctrl-0:
    required: true

  pinctrl-names:
    required: true

  pixclk_sampling_falling:
    required: true
    type: int

  hsync_active_low:
    required: true
    type: int

  vsync_active_low:
    required: true
    type: int

  interface:
    type: string
    description: |
      Description A human-readable string describing the camera interface type.
      Applications can use it to identify whether the interface used by the CAM is mipi or dvp

  mipi_csi_controller:
    type: phandle
    description: phandle of the mipi csi controller
```

## dts/bindings/video/hpmicro,hpm_video.yaml
```yaml
# Copyright 2024 HPMicro
# SPDX-License-Identifier: Apache-2.0

description: HPMicro HPM VIDEO

compatible: "hpmicro,hpm-video"

include: [base.yaml]

properties:

  video_count:
    type: int

  sensor:
    type: phandle
    required: true
    description: phandle of connected sensor device

  camera:
    type: phandle
    required: true
    description: phandle of connected hpmicro camera
```

## modules/Kconfig
```kconfig
# Copyright (c) 2024 HPMicro
# SPDX-License-Identifier: Apache-2.0

rsource "hpm_sdk/Kconfig"

comment "hpm_sdk module not available."
	depends on !ZEPHYR_HPM_SDK_MODULE
```

## modules/hpm_sdk/Kconfig
```kconfig
# Copyright (c) 2024 HPMicro
# SPDX-License-Identifier: Apache-2.0
config ZEPHYR_HPM_SDK_MODULE
	bool

config NDEBUG_CONSOLE
	bool "HPMSDK NO CONSOLE"

if ZEPHYR_HPM_SDK_MODULE

config HAS_HPMSDK_UART
	bool
config HAS_HPMSDK_SDP
	bool
config HAS_HPMSDK_LCDC
	bool
config HAS_HPMSDK_I2C
	bool
config HAS_HPMSDK_PMP
	bool
config HAS_HPMSDK_RNG
	bool
config HAS_HPMSDK_GPIO
	bool
config HAS_HPMSDK_SPI
	bool
config HAS_HPMSDK_PDMA
	bool
config HAS_HPMSDK_WDG
	bool
config HAS_HPMSDK_DMA
	bool
config HAS_HPMSDK_DMAV2
	bool
config HAS_HPMSDK_GPTMR
	bool
config HAS_HPMSDK_PWM
	bool
config HAS_HPMSDK_PLLCTL
	bool
config HAS_HPMSDK_PLLCTLV2
	bool
config HAS_HPMSDK_USB
	bool
config HAS_HPMSDK_RTC
	bool
config HAS_HPMSDK_ACMP
	bool
config HAS_HPMSDK_I2S
	bool
config HAS_HPMSDK_DAO
	bool
config HAS_HPMSDK_PDM
	bool
config HAS_HPMSDK_VAD
	bool
config HAS_HPMSDK_CAM
	bool
config HAS_HPMSDK_CAN
	bool
config HAS_HPMSDK_JPEG
	bool
config HAS_HPMSDK_ENET
	bool
config HAS_HPMSDK_SDXC
	bool
config HAS_HPMSDK_ADC12
	bool
config HAS_HPMSDK_ADC16
	bool
config HAS_HPMSDK_PMU
	bool
config HAS_HPMSDK_PTPC
	bool
config HAS_HPMSDK_MCHTMR
	bool
config HAS_HPMSDK_FFA
	bool
config HAS_HPMSDK_TSNS
	bool
config HAS_HPMSDK_DAC
	bool
config HAS_HPMSDK_PCFG
	bool
config HAS_HPMSDK_FEMC
	bool
config HAS_HPMSDK_MIPI_DSI_PHY
	bool
config HAS_HPMSDK_MIPI_DSI
	bool
config HAS_HPMSDK_PIXELMUX
	bool
config HAS_HPMSDK_LVB
	bool
config HAS_HPMSDK_MIPI_CSI
	bool
config HAS_HPMSDK_LCB
	bool
config HAS_HPMSDK_MIPI_CSI_PHY
	bool
endif 
```
