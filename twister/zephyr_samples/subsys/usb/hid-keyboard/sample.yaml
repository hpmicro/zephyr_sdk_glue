## twister/zephyr_samples/subsys/usb/hid-keyboard/sample.yaml
```yaml
# Copyright (c) 2026 HPMicro
# SPDX-License-Identifier: Apache-2.0

sample:
  name: USB HID keyboard sample
tests:
  hpmicro.sample.subsys.usb.hid_keyboard:
    timeout: 15
    harness: console
    harness_config:
      type: one_line
      regex:
      - HID keyboard sample is initialized
    tags:
    - hpmicro_verified
    - usbd
    - gpio
    depends_on:
    - usbd
    - gpio
    filter: dt_alias_exists("sw0") and dt_alias_exists("led0")
    required_snippets:
    - hid-keyboard
    platform_allow: &platforms
    - hpm5100evk
    - hpm5300evk
    - hpm5301evklite
    - hpm5e00evk
    - hpm6200evk
    - hpm6300evk
    - hpm6750evk2
    - hpm6800evk
    - hpm6e00evk
    - hpm6p00evk
    integration_platforms: *platforms
```

## twister/zephyr_samples/subsys/usb/hid-mouse/sample.yaml
```yaml
# Copyright (c) 2026 HPMicro
# SPDX-License-Identifier: Apache-2.0

sample:
  name: USB HID mouse sample
tests:
  hpmicro.sample.subsys.usb.hid_mouse:
    harness: button
    tags:
    - hpmicro_verified
    - usbd
    - gpio
    depends_on:
    - usbd
    - gpio
    filter: dt_alias_exists("sw0") and dt_alias_exists("led0")
    required_snippets:
    - hid-mouse
    platform_allow: &platforms
    - hpm5100evk
    - hpm5300evk
    - hpm5301evklite
    - hpm5e00evk
    - hpm6200evk
    - hpm6300evk
    - hpm6750evk2
    - hpm6800evk
    - hpm6e00evk
    - hpm6p00evk
    integration_platforms: *platforms
```

## twister/zephyr_samples/subsys/usb/mass/sample.yaml
```yaml
# Copyright (c) 2026 HPMicro
# SPDX-License-Identifier: Apache-2.0

sample:
  name: Mass Storage
tests:
  hpmicro.sample.subsys.usb.mass:
    extra_args:
    - EXTRA_DTC_OVERLAY_FILE="ramdisk.overlay"
    min_ram: 128
    harness: console
    harness_config:
      type: multi_line
      ordered: true
      regex:
      - No file system selected
      - The device is put in USB mass storage mode
    tags:
    - hpmicro_verified
    - usbd
    depends_on:
    - usbd
    required_snippets:
    - mass
    platform_allow: &platforms
    - hpm5100evk
    - hpm5300evk
    - hpm5301evklite
    - hpm5e00evk
    - hpm6200evk
    - hpm6300evk
    - hpm6750evk2
    - hpm6800evk
    - hpm6e00evk
    - hpm6p00evk
    integration_platforms: *platforms
```

## twister/zephyr_tests/drivers/counter/counter_basic_api/testcase.yaml
```yaml
# Copyright (c) 2026 HPMicro
# SPDX-License-Identifier: Apache-2.0

sample:
  name: HPMicro Drivers Counter Counter Basic Api test
tests:
  hpmicro.test.drivers.counter.counter_basic_api:
    timeout: 600
    min_ram: 16
    tags:
    - hpmicro_verified
    - counter
    depends_on:
    - counter
    required_snippets:
    - counter
    platform_allow: &platforms
    - hpm5100evk
    - hpm5300evk
    - hpm5301evklite
    - hpm5e00evk
    - hpm6200evk
    - hpm6300evk
    - hpm6750evk2
    - hpm6800evk
    - hpm6e00evk
    - hpm6p00evk
    integration_platforms: *platforms
```

## twister/zephyr_tests/drivers/disk/disk_access/testcase.yaml
```yaml
# Copyright (c) 2026 HPMicro
# SPDX-License-Identifier: Apache-2.0

sample:
  name: HPMicro Drivers Disk Disk Access test
tests:
  hpmicro.test.drivers.disk.disk_access:
    harness: ztest
    tags:
    - hpmicro_verified
    - sdhc
    depends_on:
    - sdhc
    filter: CONFIG_SDHC
    required_snippets:
    - sdhc
    platform_allow: &platforms
    - hpm6300evk
    - hpm6750evk2
    - hpm6800evk
    integration_platforms: *platforms
```

## twister/zephyr_tests/drivers/disk/disk_performance/testcase.yaml
```yaml
# Copyright (c) 2026 HPMicro
# SPDX-License-Identifier: Apache-2.0

sample:
  name: HPMicro Drivers Disk Disk Performance test
tests:
  hpmicro.test.drivers.disk.disk_performance:
    harness: ztest
    tags:
    - hpmicro_verified
    - sdhc
    depends_on:
    - sdhc
    required_snippets:
    - sdhc
    platform_allow: &platforms
    - hpm6300evk
    - hpm6750evk2
    - hpm6800evk
    integration_platforms: *platforms
```

## twister/zephyr_tests/drivers/entropy/api/testcase.yaml
```yaml
# Copyright (c) 2026 HPMicro
# SPDX-License-Identifier: Apache-2.0

sample:
  name: HPMicro Drivers Entropy Api test
tests:
  hpmicro.test.drivers.entropy.api:
    tags:
    - hpmicro_verified
    - entropy
    depends_on:
    - entropy
    filter: CONFIG_ENTROPY_HAS_DRIVER
    required_snippets:
    - entropy
    platform_allow: &platforms
    - hpm5300evk
    - hpm6200evk
    - hpm6300evk
    - hpm6750evk2
    - hpm6800evk
    - hpm6e00evk
    - hpm6p00evk
    integration_platforms: *platforms
```

## twister/zephyr_tests/drivers/sdhc/testcase.yaml
```yaml
# Copyright (c) 2026 HPMicro
# SPDX-License-Identifier: Apache-2.0

sample:
  name: HPMicro Drivers Sdhc test
tests:
  hpmicro.test.drivers.sdhc:
    harness: ztest
    tags:
    - hpmicro_verified
    - sdhc
    depends_on:
    - sdhc
    filter: dt_alias_exists("sdhc0")
    required_snippets:
    - sdhc
    platform_allow: &platforms
    - hpm6300evk
    - hpm6750evk2
    - hpm6800evk
    integration_platforms: *platforms
```

## twister/zephyr_tests/drivers/uart/uart_basic_api/testcase.yaml
```yaml
# Copyright (c) 2026 HPMicro
# SPDX-License-Identifier: Apache-2.0

sample:
  name: HPMicro Drivers Uart Uart Basic Api test
tests:
  hpmicro.test.drivers.uart.uart_basic_api:
    harness: keyboard
    tags:
    - hpmicro_verified
    - uart
    depends_on:
    - uart
    filter: CONFIG_UART_CONSOLE
    platform_allow: &platforms
    - hpm5100evk
    - hpm5300evk
    - hpm5301evklite
    - hpm5e00evk
    - hpm6200evk
    - hpm6300evk
    - hpm6750evk2
    - hpm6800evk
    - hpm6e00evk
    - hpm6p00evk
    integration_platforms: *platforms
```

## twister/zephyr_tests/drivers/watchdog/wdt_basic_reset_none/testcase.yaml
```yaml
# Copyright (c) 2026 HPMicro
# SPDX-License-Identifier: Apache-2.0

sample:
  name: HPMicro Drivers Watchdog Wdt Basic Reset None test
tests:
  hpmicro.test.drivers.watchdog.wdt_basic_reset_none:
    tags:
    - hpmicro_verified
    - watchdog
    depends_on:
    - watchdog
    filter: dt_alias_exists("watchdog0")
    required_snippets:
    - watchdog
    platform_allow: &platforms
    - hpm5100evk
    - hpm5300evk
    - hpm5301evklite
    - hpm5e00evk
    - hpm6200evk
    - hpm6300evk
    - hpm6750evk2
    - hpm6800evk
    - hpm6e00evk
    - hpm6p00evk
    integration_platforms: *platforms
```

## twister/zephyr_tests/kernel/cache/testcase.yaml
```yaml
# Copyright (c) 2026 HPMicro
# SPDX-License-Identifier: Apache-2.0

sample:
  name: HPMicro Kernel Cache API test
tests:
  hpmicro.test.kernel.cache:
    tags:
      - hpmicro_verified
    filter: CONFIG_CACHE_MANAGEMENT
    required_snippets:
      - cache
    platform_allow: &platforms
      - hpm5100evk
      - hpm5300evk
      - hpm5301evklite
      - hpm5e00evk
      - hpm6200evk
      - hpm6300evk
      - hpm6750evk2
      - hpm6800evk
      - hpm6e00evk
      - hpm6p00evk
    integration_platforms: *platforms
```

## twister/zephyr_tests/subsys/sd/mmc/testcase.yaml
```yaml
# Copyright (c) 2026 HPMicro
# SPDX-License-Identifier: Apache-2.0

sample:
  name: HPMicro Subsys Sd Mmc test
tests:
  hpmicro.test.subsys.sd.mmc:
    min_ram: 32
    harness: ztest
    tags:
    - hpmicro_verified
    - sdhc
    depends_on:
    - sdhc
    filter: dt_alias_exists("sdhc0") and dt_compat_enabled("zephyr,mmc-disk")
    required_snippets:
    - sdhc
    platform_allow: &platforms
    - hpm6300evk
    - hpm6750evk2
    - hpm6800evk
    integration_platforms: *platforms
```

## twister/zephyr_tests/subsys/sd/sdmmc/testcase.yaml
```yaml
# Copyright (c) 2026 HPMicro
# SPDX-License-Identifier: Apache-2.0

sample:
  name: HPMicro Subsys Sd Sdmmc test
tests:
  hpmicro.test.subsys.sd.sdmmc:
    min_ram: 32
    harness: ztest
    tags:
    - hpmicro_verified
    - sdhc
    depends_on:
    - sdhc
    filter: dt_compat_enabled("zephyr,sdmmc-disk")
    required_snippets:
    - sdhc
    platform_allow: &platforms
    - hpm6300evk
    - hpm6750evk2
    - hpm6800evk
    integration_platforms: *platforms
```

## west.yml
```yaml
# Copyright (c) 2026 HPMicro
# SPDX-License-Identifier: Apache-2.0

# The west manifest file (west.yml) for the hpmicro SDK.
#
# The per-workspace west configuration file, .west/config,
# specifies the location of this manifest file like this:
#
#     [manifest]
#     path = sdk_glue

########################################
##  zephyr                    v4.4.0  ##
##  hpm_sdk                   v1.13.0 ##
########################################
manifest:
  version: "1.0"

  remotes:
    - name: test
      url-base: git@192.168.11.211:oss
    - name: sw
      url-base: git@192.168.11.211:sw
    - name: github
      url-base: https://github.com/hpmicro
    - name: cherry-embedded
      url-base: https://github.com/cherry-embedded/

  defaults:
    remote: github

  projects:
    - name: zephyr
      repo-path: zephyr
      revision: zsg_v0.8.0
      import:
        name-allowlist:
          - west-commands
          - mbedtls
          - tf-psa-crypto
    - name: sdk_env
      repo-path: sdk_env
      path: sdk_env
      revision: v1.13.0
      submodules: true
    - name: canopennode
      repo-path: canopennode
      path: modules/lib/canopennode
      revision: dec12fa3f0d790cafa8414a4c2930ea71ab72ffd
    - name: lvgl
      repo-path: zephyr_lvgl
      path: modules/lib/gui/lvgl
      revision: 85aa60d18b3d5e5588d7b247abf90198f07c8a63
    - name: CherryUSB
      remote: cherry-embedded
      repo-path: CherryUSB
      path: modules/lib/CherryUSB
      revision: 4b830cf6bf804542cdd0cf14dd010fddeb990f8b
    - name: fatfs
      repo-path: fatfs
      path: modules/fs/fatfs
      revision: 42c2d6ee77e108d2a6d05e862ef0be23511db204
    - name: mcuboot
      repo-path: mcuboot
      revision: 5af38164715eb75b4319588f6a41d71466e7060a
      path: bootloader/mcuboot


  # West-related configuration for the sdk_glue repository.
  self:
    path: sdk_glue
    west-commands: scripts/west-commands.yml
```
