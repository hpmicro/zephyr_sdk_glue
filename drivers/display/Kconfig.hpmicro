## dts/bindings/display/hpmicro,hpm-display.yaml
```yaml
# Copyright 2024 HPMicro
# SPDX-License-Identifier: Apache-2.0

description: HPMicro DISPLAY

include: ["base.yaml","pinctrl-device.yaml"]

properties:
  panel_name:
    type: string
  endpoint_in:
    type: phandle
    required: true
    description: video data source of the panel
  pixel_clock_khz:
    type: int
    required: true
    description: pixel clock of display panel, UINT KHz
  hactive:
    type: int
    required: true
  hfront_porch:
    type: int
    required: true
  hback_porch:
    type: int
    required: true
  hsync_len:
    type: int
    required: true
  vactive:
    type: int
    required: true
  vfront_porch:
    type: int
    required: true
  vback_porch:
    type: int
    required: true
  vsync_len:
    type: int
    required: true
  hsync_pol:
    type: int
    default: 0
    description: Horizontal Synchronization Signal Polarity, 0-High Active, 1-Low Active
  vsync_pol:
    type: int
    default: 0
    description: Vertical Synchronization Signal Polarity, 0-High Active, 1-Low Active
  de_pol:
    type: int
    default: 0
    description: Data Enable Signal Polarity, 0-High Active, 1-Low Active
  pixel_clk_pol:
    type: int
    default: 0
    description: Pixel Clock Signal Polarity, 0-High Active, 1-Low Active
  pixel_data_pol:
    type: int
    default: 0
    description: Pixel Data Signal Polarity, 0-High Active, 1-Low Active
  reset-time-active:
    type: int
    default: 0
    description: time of panel reset period, uint ms
  reset-time-inactive:
    type: int
    default: 0
    description: time of panel reset release, uint ms
  pixel-format:
    type: int
    default: 8
    enum:
      - 8
      - 16
  gpios:
    type: phandle-array
  backlight-gpios:
    type: phandle-array
  reset-gpios:
    type: phandle-array
  cfg-gpios:
    type: phandle-array
    description: use to panel configrate
```

## dts/bindings/display/hpmicro,hpm-lcdc.yaml
```yaml
# Copyright 2024 HPMicro
# SPDX-License-Identifier: Apache-2.0

description: HPMicro HPM LCDC

compatible: "hpmicro,hpm-lcdc"

include: ["base.yaml"]

properties:
  id:
    type: int
    required: true
    description: ip instance number
  router:
    type: phandle
    description: lcdc router module(pxelmux)
  
```

## dts/bindings/display/hpmicro,hpm-lvb.yaml
```yaml
# Copyright 2024 HPMicro
# SPDX-License-Identifier: Apache-2.0

description: HPMicro HPM LVB
compatible: "hpmicro,hpm-lvb"
include: ["base.yaml"]

child-binding:
  description: phy in lvb
  compatible: "hpmicro,hpm-lvds"
  include: ["base.yaml"]
  properties:
    endpoint_in:
      type: phandle
      required: true
      description: video data source of the lvds
    ch_mapping:
      type: int
      default: 0
      enum:
       - 0
       - 1
      description: channel mapping(lvds format). 0-vesa, 1-jeida
    rterm_enable:
      type: int
      default: 1
      enum:
      - 0
      - 1
      description: enbale terminal resistance. 0-disable, 1-enable
    amp_mv:
      type: int
      default: 5
      enum:
        - 0
        - 1
        - 2
        - 3
        - 4
        - 5
        - 6
        - 7
        - 8
        - 9
        - 10
        - 11
      description: |
        Output voltage Adjustment.
        lvb_lvds_lane_amp_50_mv = 0
        lvb_lvds_lane_amp_100_mv = 1
        lvb_lvds_lane_amp_150_mv = 2
        lvb_lvds_lane_amp_200_mv = 3
        lvb_lvds_lane_amp_250_mv = 4
        lvb_lvds_lane_amp_300_mv = 5
        lvb_lvds_lane_amp_350_mv = 6
        lvb_lvds_lane_amp_400_mv = 7
        lvb_lvds_lane_amp_450_mv = 8
        lvb_lvds_lane_amp_500_mv = 9
        lvb_lvds_lane_amp_550_mv = 10
        lvb_lvds_lane_amp_600_mv = 11
    vcom_mv:
      type: int
      default: 5
      enum:
        - 0
        - 1
        - 2
        - 3
        - 4
        - 5
        - 6
        - 7
        - 8
      description: |
        lvb_lvds_lane_vcom_0_7_v = 0
        lvb_lvds_lane_vcom_0_8_v = 1
        lvb_lvds_lane_vcom_0_9_v = 2
        lvb_lvds_lane_vcom_1_0_v = 3
        lvb_lvds_lane_vcom_1_1_v = 4
        lvb_lvds_lane_vcom_1_2_v = 5
        lvb_lvds_lane_vcom_1_3_v = 6
        lvb_lvds_lane_vcom_1_4_v = 7
        lvb_lvds_lane_vcom_1_5_v = 8
```
