## boards/hpmicro/hpm5100evk/Kconfig
```kconfig
# Copyright (c) 2026 HPMicro
# SPDX-License-Identifier: Apache-2.0

config BOARD_HPM5100EVK
	select SOC_HPM5151
```

## boards/hpmicro/hpm5100evk/board.yml
```yaml
board:
  name: hpm5100evk
  full_name: hpm5100evk
  vendor: hpmicro
  socs:
    - name: hpm5151
```

## boards/hpmicro/hpm5300evk/Kconfig.defconfig
```kconfig
# Copyright (c) 2026 HPMicro
# SPDX-License-Identifier: Apache-2.0

if BOARD_HPM5300EVK

config HEAP_MEM_POOL_SIZE
	default 8192

config BUILD_OUTPUT_HEX
	default y

config UART_INTERRUPT_DRIVEN
	default y

endif
```

## boards/hpmicro/hpm5300evk/board.yml
```yaml
board:
  name: hpm5300evk
  full_name: hpm5300evk
  vendor: hpmicro
  socs:
    - name: hpm5361
```

## boards/hpmicro/hpm5300evk/hpm5300evk_defconfig
```kconfig
# Copyright (c) 2026 HPMicro
# SPDX-License-Identifier: Apache-2.0

CONFIG_CONSOLE=y
CONFIG_UART_CONSOLE=y
# Execute in place support
CONFIG_XIP=y
CONFIG_PINCTRL=y
CONFIG_GPIO=y
CONFIG_SERIAL=y
CONFIG_FLASH=y
CONFIG_NOCACHE_MEMORY=y
```

## boards/hpmicro/hpm5301evklite/Kconfig
```kconfig
# Copyright (c) 2026 HPMicro
# SPDX-License-Identifier: Apache-2.0

config BOARD_HPM5301EVKLITE
	select SOC_HPM5301
```

## boards/hpmicro/hpm5301evklite/board.yml
```yaml
# Copyright (c) 2026 HPMicro
# SPDX-License-Identifier: Apache-2.0

board:
  name: hpm5301evklite
  full_name: hpm5301evklite
  vendor: hpmicro
  socs:
    - name: hpm5301
```

## boards/hpmicro/hpm5e00evk/Kconfig
```kconfig
# Copyright (c) 2026 HPMicro
# SPDX-License-Identifier: Apache-2.0

if BOARD_HPM5E00EVK

config INIT_EXT_RAM
    bool "Initialize external RAM(SDRAM or DDR)"
    default n
    select HAS_HPMSDK_FEMC

config HPMICRO_BOARD_SUPPORT_EMMC
    bool "SUPPORT EMMC"
    default n
    help
      SUPPORT EMMC

config HPMICRO_BOARD_SUPPORT_SD_DETECT
    bool "SUPPORT SD DETECT"
    default n
    help
        SUPPORT SD DETECT

endif #BOARD_HPM5E00EVK
```

## boards/hpmicro/hpm5e00evk/Kconfig.defconfig
```kconfig
# Copyright (c) 2026 HPMicro
# SPDX-License-Identifier: Apache-2.0

if BOARD_HPM5E00EVK

config HEAP_MEM_POOL_SIZE
	default 16384

config BUILD_OUTPUT_HEX
	default y

config UART_INTERRUPT_DRIVEN
	default y

endif
```

## boards/hpmicro/hpm5e00evk/Kconfig.hpm5e00evk
```kconfig
# Copyright (c) 2026 HPMicro
# SPDX-License-Identifier: Apache-2.0

config BOARD_HPM5E00EVK
	select SOC_HPM5E31
	select BOARD_EARLY_INIT_HOOK
```

## boards/hpmicro/hpm5e00evk/board.yml
```yaml
# Copyright (c) 2026 HPMicro
# SPDX-License-Identifier: Apache-2.0

board:
  name: hpm5e00evk
  full_name: hpm5e00evk
  vendor: hpmicro
  socs:
    - name: hpm5e31
```

## boards/hpmicro/hpm6200evk/Kconfig
```kconfig
# Copyright (c) 2025 HPMicro
# SPDX-License-Identifier: BSD-3-Clause

if BOARD_HPM6200EVK

config INIT_EXT_RAM
    bool "Initialize external RAM(SDRAM or DDR)"
    default n
    select HAS_HPMSDK_FEMC

config HPMICRO_BOARD_SUPPORT_EMMC
    bool "SUPPORT EMMC"
    default n
    help
      SUPPORT EMMC

config HPMICRO_BOARD_SUPPORT_SD_DETECT
    bool "SUPPORT SD DETECT"
    default n
    help
        SUPPORT SD DETECT
endif #BOARD_HPM6200EVK
```

## boards/hpmicro/hpm6200evk/board.yml
```yaml
board:
  name: hpm6200evk
  full_name: hpm6200evk
  vendor: hpmicro
  socs:
    - name: hpm6280
```

## boards/hpmicro/hpm6300evk/Kconfig
```kconfig
# Copyright (c) 2026 HPMicro
# SPDX-License-Identifier: Apache-2.0

if BOARD_HPM6300EVK

config INIT_EXT_RAM
    bool "Initialize external RAM(SDRAM or DDR)"
    default y
    select HAS_HPMSDK_FEMC

config HPMICRO_BOARD_SUPPORT_EMMC
    bool "SUPPORT EMMC"
    default n
    help
      SUPPORT EMMC

config HPMICRO_BOARD_SUPPORT_SD_DETECT
    bool "SUPPORT SD DETECT"
    default n
    help
        SUPPORT SD DETECT
endif #BOARD_HPM6300EVK
```

## boards/hpmicro/hpm6300evk/Kconfig.hpm6300evk
```kconfig
# Copyright (c) 2026 HPMicro
# SPDX-License-Identifier: Apache-2.0

config BOARD_HPM6300EVK
	select SOC_HPM6360
	select BOARD_EARLY_INIT_HOOK
```

## boards/hpmicro/hpm6300evk/board.yml
```yaml
# Copyright (c) 2026 HPMicro
# SPDX-License-Identifier: Apache-2.0

board:
  name: hpm6300evk
  full_name: hpm6300evk
  vendor: hpmicro
  socs:
    - name: hpm6360
```

## boards/hpmicro/hpm6750evk2/Kconfig.hpm6750evk2
```kconfig
# Copyright (c) 2022-2026 HPMicro
# SPDX-License-Identifier: Apache-2.0

config BOARD_HPM6750EVK2
	select SOC_HPM6750
	select BOARD_EARLY_INIT_HOOK
```

## boards/hpmicro/hpm6750evk2/board.yml
```yaml
board:
  name: hpm6750evk2
  full_name: hpm6750evk2
  vendor: hpmicro
  socs:
    - name: hpm6750
```

## boards/hpmicro/hpm6800evk/Kconfig
```kconfig
# Copyright (c) 2024 HPMicro
# SPDX-License-Identifier: Apache-2.0

if BOARD_HPM6800EVK

config INIT_EXT_RAM
    bool "Initialize external RAM(SDRAM or DDR)"
    default y

choice
	prompt "DDR Type Selection"
	depends on INIT_EXT_RAM
	default DDR3L

config DDR2
    bool "DDR Type DDR2"

config DDR3L
    bool "DDR Type DDR3L"
endchoice

config HPMICRO_BOARD_SUPPORT_EMMC
    bool "SUPPORT EMMC"
    default n
    help
        SUPPORT EMMC

config HPMICRO_BOARD_SUPPORT_SD_DETECT
    bool "SUPPORT SD DETECT"
    default n
    help
        SUPPORT SD DETECT
endif #BOARD_HPM6800EVK
```

## boards/hpmicro/hpm6800evk/Kconfig.hpm6800evk
```kconfig
# Copyright (c) 2024-2026 HPMicro
# SPDX-License-Identifier: Apache-2.0

config BOARD_HPM6800EVK
	select SOC_HPM6880
	select BOARD_EARLY_INIT_HOOK
```

## boards/hpmicro/hpm6800evk/board.yml
```yaml
board:
  name: hpm6800evk
  full_name: hpm6800evk
  vendor: hpmicro
  socs:
    - name: hpm6880
```

## boards/hpmicro/hpm6e00evk/Kconfig.hpm6e00evk
```kconfig
# Copyright (c) 2025-2026 HPMicro
# SPDX-License-Identifier: Apache-2.0

config BOARD_HPM6E00EVK
	select SOC_HPM6E80
	select BOARD_EARLY_INIT_HOOK
```

## boards/hpmicro/hpm6e00evk/board.yml
```yaml
board:
  name: hpm6e00evk
  full_name: hpm6e00evk
  vendor: hpmicro
  socs:
    - name: hpm6e80
```

## boards/hpmicro/hpm6p00evk/Kconfig.hpm6p00evk
```kconfig
# Copyright (c) 2026 HPMicro
# SPDX-License-Identifier: Apache-2.0

config BOARD_HPM6P00EVK
	select SOC_HPM6P81
	select BOARD_EARLY_INIT_HOOK
```

## boards/hpmicro/hpm6p00evk/board.yml
```yaml
# Copyright (c) 2026 HPMicro
# SPDX-License-Identifier: Apache-2.0

board:
  name: hpm6p00evk
  full_name: hpm6p00evk
  vendor: hpmicro
  socs:
    - name: hpm6p81
```
