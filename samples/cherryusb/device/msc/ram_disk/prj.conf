## CMakeLists.txt
```
# Copyright (c) 2025 HPMicro
# SPDX-License-Identifier: Apache-2.0

cmake_minimum_required(VERSION 3.20.0)
find_package(Zephyr REQUIRED HINTS $ENV{ZEPHYR_BASE})
project(cherryusb_device_msc_ram)

FILE(GLOB app_sources src/*.c)
target_sources(app PRIVATE ${app_sources})

set(CHERRYUSB_CONFIG_DIR ${HPM_ZEPHYR_DIR}/samples/cherryusb/config)
zephyr_include_directories(${CHERRYUSB_CONFIG_DIR})
```

## sample.yaml
```
# Copyright (c) 2026 HPMicro
# SPDX-License-Identifier: Apache-2.0

sample:
  name: CherryUSB Device Mass Storage
tests:
  hpmicro.sample.cherryusb.device.msc.ram_disk:
    tags:
      - hpmicro_verified
      - usbd
    depends_on:
      - usbd
    platform_allow: &platforms
      - hpm5100evk
      - hpm5300evk
      - hpm5301evklite
      - hpm5e00evk
      - hpm6200evk
      - hpm6300evk
      - hpm6750evk2
      - hpm6800evk
      - hpm6e00evk
      - hpm6p00evk
    integration_platforms: *platforms
```

## prj.conf
```kconfig
CONFIG_STDOUT_CONSOLE=y

# CherryUSB related configs
CONFIG_CHERRYUSB=y
CONFIG_CHERRYUSB_DEVICE=y
CONFIG_CHERRYUSB_DEVICE_SPEED_AUTO=y
CONFIG_CHERRYUSB_DEVICE_HPM=y
CONFIG_CHERRYUSB_DEVICE_MSC=y

CONFIG_MAIN_STACK_SIZE=1536
```

## app.overlay
```dts
/*
 * Copyright 2025 HPMicro
 * SPDX-License-Identifier: Apache-2.0
 */


cherryusb_usb0: &usb0 {
	compatible = "hpmicro,hpm-cherryusb";
	status = "okay";
};
```

## src/main.c
```c
/*
 * Copyright (c) 2025 HPMicro
 *
 * SPDX-License-Identifier: BSD-3-Clause
 *
 */

#include <stdio.h>
#include <zephyr/devicetree.h>

extern void msc_ram_init(uint8_t busid, uint32_t reg_base);

int main(void)
{
    uint32_t usb_base = DT_REG_ADDR(DT_NODELABEL(cherryusb_usb0));

    printf("cherry usb msc_ram sample.\n");

    msc_ram_init(0, usb_base);

    return 0;
}
```
