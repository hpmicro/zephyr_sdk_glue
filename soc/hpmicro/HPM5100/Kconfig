## twister/zephyr_samples/drivers/display/sample.yaml
```yaml
# Copyright (c) 2026 HPMicro
# SPDX-License-Identifier: Apache-2.0

sample:
  description: Sample application for displays
  name: display_sample
tests:
  hpmicro.sample.drivers.display.rgb:
    harness: console
    harness_config:
      fixture: tm070rdh13
    tags:
    - hpmicro_verified
    - display
    depends_on:
    - display
    filter: dt_chosen_enabled("zephyr,display")
    required_snippets:
    - display_rgb
    platform_allow: &platforms
    - hpm6750evk2
    - hpm6800evk
    integration_platforms: *platforms
  hpmicro.sample.drivers.display.mipi:
    harness: console
    harness_config:
      fixture: mc10128007_31b
    tags:
    - hpmicro_verified
    - display
    - mipi-dsi
    depends_on:
    - display
    - mipi-dsi
    filter: dt_chosen_enabled("zephyr,display")
    required_snippets:
    - display_mipi
    platform_allow: &platforms_2
    - hpm6800evk
    integration_platforms: *platforms_2
  hpmicro.sample.drivers.display.lvds:
    harness: console
    harness_config:
      fixture: cc10128007
    tags:
    - hpmicro_verified
    - display
    - lvds
    depends_on:
    - display
    - lvds
    filter: dt_chosen_enabled("zephyr,display")
    required_snippets:
    - display_lvds
    platform_allow: &platforms_3
    - hpm6800evk
    integration_platforms: *platforms_3
  hpmicro.sample.drivers.display.dual_lvds:
    harness: console
    harness_config:
      fixture: tm103xdgp01
    tags:
    - hpmicro_verified
    - display
    - lvds
    depends_on:
    - display
    - lvds
    filter: dt_chosen_enabled("zephyr,display")
    required_snippets:
    - display_dual_lvds
    platform_allow: &platforms_4
    - hpm6800evk
    integration_platforms: *platforms_4
```

## twister/zephyr_samples/drivers/eeprom/sample.yaml
```yaml
# Copyright (c) 2026 HPMicro
# SPDX-License-Identifier: Apache-2.0

sample:
  name: EEPROM Sample
tests:
  hpmicro.sample.drivers.eeprom:
    harness: console
    harness_config:
      type: one_line
      regex:
      - Reset the MCU to see the increasing boot counter.
    tags:
    - hpmicro_verified
    - i2c
    depends_on:
    - i2c
    required_snippets:
    - i2c_eeprom
    platform_allow: &platforms
    - hpm6750evk2
    - hpm6800evk
    - hpm6e00evk
    integration_platforms: *platforms
```

## twister/zephyr_samples/drivers/video/capture/sample.yaml
```yaml
# Copyright (c) 2026 HPMicro
# SPDX-License-Identifier: Apache-2.0

sample:
  name: Video capture
tests:
  hpmicro.sample.drivers.video.capture.dvp:
    harness: console
    harness_config:
      type: multi_line
      ordered: true
      regex:
      - Got frame \d+
      - 'size: \d+;'
      - timestamp \d+
    tags:
    - hpmicro_verified
    - video
    depends_on:
    - video
    required_snippets:
    - video_dvp
    platform_allow: &platforms
    - hpm6750evk2
    - hpm6800evk
    integration_platforms: *platforms
  hpmicro.sample.drivers.video.capture.mipi:
    extra_configs:
    - CONFIG_FPU=y
    harness: console
    harness_config:
      type: multi_line
      ordered: true
      regex:
      - Got frame \d+
      - 'size: \d+;'
      - timestamp \d+
    tags:
    - hpmicro_verified
    - video
    - mipi-csi
    depends_on:
    - video
    - mipi-csi
    required_snippets:
    - video_mipi
    platform_allow: &platforms_2
    - hpm6800evk
    integration_platforms: *platforms_2
```

## twister/zephyr_samples/hello_world/sample.yaml
```yaml
# Copyright (c) 2026 HPMicro
# SPDX-License-Identifier: Apache-2.0

sample:
  description: Hello World sample, the simplest Zephyr application
  name: hello world
tests:
  hpmicro.sample.hello_world:
    min_ram: 2
    min_flash: 16
    harness: console
    harness_config:
      type: one_line
      regex:
      - Hello World! (.*)
    tags:
    - hpmicro_verified
    platform_allow: &platforms
    - hpm5100evk
    - hpm5300evk
    - hpm5301evklite
    - hpm5e00evk
    - hpm6200evk
    - hpm6300evk
    - hpm6750evk2
    - hpm6800evk
    - hpm6e00evk
    - hpm6p00evk
    integration_platforms: *platforms
```

## twister/zephyr_samples/modules/canopennode/sample.yaml
```yaml
# Copyright (c) 2026 HPMicro
# SPDX-License-Identifier: Apache-2.0

sample:
  name: CANopenNode sample
tests:
  hpmicro.sample.modules.canopennode:
    modules:
    - canopennode
    harness: console
    harness_config:
      type: one_line
      regex:
      - (.*)CANopen stack initialized
    tags:
    - hpmicro_verified
    - can
    depends_on:
    - can
    filter: dt_chosen_enabled("zephyr,canbus")
    required_snippets:
    - canopennode
    platform_allow: &platforms
    - hpm5100evk
    - hpm5300evk
    - hpm5e00evk
    - hpm6200evk
    - hpm6300evk
    - hpm6750evk2
    - hpm6800evk
    - hpm6e00evk
    - hpm6p00evk
    integration_platforms: *platforms
```

## twister/zephyr_samples/net/sockets/echo_server/sample.yaml
```yaml
# Copyright (c) 2026 HPMicro
# SPDX-License-Identifier: Apache-2.0

sample:
  description: Test network sockets using a client/server sample
  name: Socket Echo Server
tests:
  hpmicro.sample.net.sockets.echo_server:
    min_flash: 140
    harness: net
    tags:
    - hpmicro_verified
    - ethernet
    depends_on:
    - ethernet
    required_snippets:
    - ethernet
    platform_allow: &platforms
    - hpm5e00evk
    - hpm6300evk
    - hpm6750evk2
    - hpm6800evk
    - hpm6e00evk
    - hpm6p00evk
    integration_platforms: *platforms
```

## twister/zephyr_samples/subsys/shell/shell_module/sample.yaml
```yaml
# Copyright (c) 2026 HPMicro
# SPDX-License-Identifier: Apache-2.0

sample:
  name: Shell Sample
tests:
  hpmicro.sample.subsys.shell.shell_module:
    min_ram: 40
    harness: shell
    tags:
      - hpmicro_verified
      - uart
    depends_on:
      - uart
    filter: CONFIG_SERIAL and dt_chosen_enabled("zephyr,shell-uart")
    required_snippets:
      - shell_module
    platform_allow: &platforms
      - hpm5100evk
      - hpm5300evk
      - hpm5301evklite
      - hpm5e00evk
      - hpm6200evk
      - hpm6300evk
      - hpm6750evk2
      - hpm6800evk
      - hpm6e00evk
      - hpm6p00evk
    integration_platforms: *platforms
```

## twister/zephyr_samples/subsys/usb/cdc_acm/sample.yaml
```yaml
# Copyright (c) 2026 HPMicro
# SPDX-License-Identifier: Apache-2.0

sample:
  name: CDC ACM USB
tests:
  hpmicro.sample.subsys.usb.cdc_acm:
    harness: console
    harness_config:
      type: one_line
      regex:
      - Wait for DTR
    tags:
    - hpmicro_verified
    - usbd
    depends_on:
    - usbd
    required_snippets:
    - cdc_acm
    platform_allow: &platforms
    - hpm5100evk
    - hpm5300evk
    - hpm5301evklite
    - hpm5e00evk
    - hpm6200evk
    - hpm6300evk
    - hpm6750evk2
    - hpm6800evk
    - hpm6e00evk
    - hpm6p00evk
    integration_platforms: *platforms
```
