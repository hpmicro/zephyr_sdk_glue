## Kconfig.hpm
```kconfig
# Copyright (c) 2024 HPMicro
# SPDX-License-Identifier: Apache-2.0

orsource "./$(BOARD_DIR)/Kconfig.board"
orsource "./$(BOARD_DIR)/Kconfig"

rsource "boards/shields/*/Kconfig.shield"

menu "Hpmicro Zephyr Glue"

rsource "drivers/Kconfig"
rsource "modules/Kconfig"

endmenu
```

## boards/hpmicro/hpm6300evk/Kconfig.board
```kconfig
# Copyright (c) 2024 HPMicro
# SPDX-License-Identifier: Apache-2.0

config BOARD_HPM6300EVK
	bool "HPMicro HPM6300EVK"
	depends on SOC_HPM6360
```

## boards/hpmicro/hpm6300evk/hpm6300evk_defconfig
```kconfig
CONFIG_SOC_HPM6360=y
CONFIG_SOC_SERIES_HPM63XX=y
CONFIG_BOARD_HPM6300EVK=y
CONFIG_XIP=y
CONFIG_PLIC=y
CONFIG_CONSOLE=y
CONFIG_UART_CONSOLE=y
CONFIG_PINCTRL=y
CONFIG_GPIO=y
CONFIG_BUILD_OUTPUT_HEX=y
CONFIG_NDEBUG_CONSOLE=y

# Serial driver options
CONFIG_SERIAL=y
CONFIG_UART_INTERRUPT_DRIVEN=y
CONFIG_UART_ASYNC_API=y

# GPIO driver options
CONFIG_GPIO=y

# HW DSP options
#CONFIG_SOC_ANDES_V5_HWDSP=y

# DMA driver options
CONFIG_DMA=y
```

## boards/hpmicro/hpm6750evk2/Kconfig.board
```kconfig
# Copyright (c) 2022 HPMicro
# SPDX-License-Identifier: Apache-2.0

config BOARD_HPM6750EVK2
	bool "HPMicro HPM6750EVK2"
	depends on SOC_HPM6750
```

## boards/hpmicro/hpm6750evk2/Kconfig.defconfig
```kconfig
# Copyright (c) 2022 HPMicro
# SPDX-License-Identifier: Apache-2.0

if BOARD_HPM6750EVK2

config HEAP_MEM_POOL_SIZE
	default 16384

config BUILD_OUTPUT_HEX
	default y

config UART_INTERRUPT_DRIVEN
	default y

endif
```

## boards/hpmicro/hpm6750evk2/hpm6750evk2_defconfig
```kconfig
CONFIG_CONSOLE=y
CONFIG_UART_CONSOLE=y
# execute in place support
CONFIG_XIP=y

# pinctrl driver option
CONFIG_PINCTRL=y

# GPIO driver option
CONFIG_GPIO=y

# Serial driver option
CONFIG_SERIAL=y

# Nocache options, place in RAM region
CONFIG_NOCACHE_MEMORY=y
```

## boards/hpmicro/hpm6800evk/Kconfig.board
```kconfig
# Copyright (c) 2024 HPMicro
# SPDX-License-Identifier: Apache-2.0

config BOARD_HPM6800EVK
	bool "HPMicro HPM6800EVK"
	depends on SOC_HPM6880
```

## boards/hpmicro/hpm6800evk/Kconfig.defconfig
```kconfig
# Copyright (c) 2024 HPMicro
# SPDX-License-Identifier: Apache-2.0

if BOARD_HPM6800EVK

config HEAP_MEM_POOL_SIZE
	default 16384

config BUILD_OUTPUT_HEX
	default y

config UART_INTERRUPT_DRIVEN
	default y

endif
```

## boards/hpmicro/hpm6800evk/hpm6800evk_defconfig
```kconfig
CONFIG_CONSOLE=y
CONFIG_UART_CONSOLE=y
# execute in place support
CONFIG_XIP=y

# pinctrl driver option
CONFIG_PINCTRL=y

# GPIO driver option
CONFIG_GPIO=y

# Serial driver option
CONFIG_SERIAL=y
```

## boards/riscv/hpm5300evk/Kconfig.board
```kconfig
# Copyright (c) 2024 hpmicro
# SPDX-License-Identifier: Apache-2.0

config BOARD_HPM5300EVK
	bool "HPMicro HPM5300EVK"
	depends on SOC_HPM5361
```

## boards/riscv/hpm5300evk/Kconfig.defconfig
```kconfig
# Copyright (c) 2024 hpmicro
# SPDX-License-Identifier: Apache-2.0

if BOARD_HPM5300EVK

DT_CHOSEN_Z_CODE_PARTITION := zephyr,code-partition

config BOARD
	default "hpm5300evk" if BOARD_HPM5300EVK

config FLASH_LOAD_OFFSET
	default $(dt_chosen_reg_addr_hex,$(DT_CHOSEN_Z_CODE_PARTITION))

config FLASH_LOAD_SIZE
	default $(dt_chosen_reg_size_hex,$(DT_CHOSEN_Z_CODE_PARTITION))

endif
```

## boards/riscv/hpm6750evk/Kconfig.board
```kconfig
# Copyright (c) 2022 hpmicro
# SPDX-License-Identifier: Apache-2.0

config BOARD_HPM6750EVK
	bool "HPMicro HPM6750EVK"
	depends on SOC_HPM6750

config BOARD_HPM6750EVK2
	bool "HPMicro HPM6750EVK2"
	depends on SOC_HPM6750
```

## boards/riscv/hpm6750evk/hpm6750evk_defconfig
```kconfig
CONFIG_SOC_HPM6750=y
CONFIG_SOC_SERIES_HPM67XX=y
CONFIG_BOARD_HPM6750EVK=y
CONFIG_XIP=y
CONFIG_PLIC=y
CONFIG_CONSOLE=y
CONFIG_UART_CONSOLE=y
CONFIG_PINCTRL=y
CONFIG_GPIO=y
CONFIG_CAN=y
CONFIG_BUILD_OUTPUT_HEX=y

CONFIG_NDEBUG_CONSOLE=y

# Serial driver options
CONFIG_SERIAL=y
CONFIG_UART_INTERRUPT_DRIVEN=y
CONFIG_UART_ASYNC_API=y

# GPIO driver options
CONFIG_GPIO=y

# HW DSP options
#CONFIG_SOC_ANDES_V5_HWDSP=y

# DMA driver options
CONFIG_DMA=y
```

## boards/riscv/hpm6750evk2/Kconfig
```kconfig
# Copyright (c) 2023 HPMicro
# SPDX-License-Identifier: BSD-3-Clause

if BOARD_HPM6750EVK2

config INIT_EXT_RAM
	bool "Initialize external RAM(SDRAM or DDR)"
	default y
	select HAS_HPMSDK_FEMC

endif #BOARD_HPM6750EVK
```

## boards/riscv/hpm6750evk2/Kconfig.defconfig
```kconfig
# Copyright (c) 2022 HPMicro
# SPDX-License-Identifier: Apache-2.0

if BOARD_HPM6750EVK2

DT_CHOSEN_Z_CODE_PARTITION := zephyr,code-partition

config BOARD
	default "hpm6750evk2" if BOARD_HPM6750EVK2

config FLASH_LOAD_OFFSET
	default $(dt_chosen_reg_addr_hex,$(DT_CHOSEN_Z_CODE_PARTITION))

config FLASH_LOAD_SIZE
	default $(dt_chosen_reg_size_hex,$(DT_CHOSEN_Z_CODE_PARTITION))

endif
```

## boards/riscv/hpm6750evk2/hpm6750evk2_defconfig
```kconfig
CONFIG_SOC_HPM6750=y
CONFIG_SOC_SERIES_HPM67XX=y
CONFIG_BOARD_HPM6750EVK2=y
CONFIG_XIP=y
CONFIG_PLIC=y
CONFIG_CONSOLE=y
CONFIG_UART_CONSOLE=y
CONFIG_PINCTRL=y
CONFIG_CAN=y
CONFIG_SPI=y
CONFIG_PWM=y
CONFIG_ADC=y
CONFIG_CLOCK_CONTROL=y
CONFIG_GPIO=y
CONFIG_BUILD_OUTPUT_HEX=y
CONFIG_NDEBUG_CONSOLE=y
CONFIG_SERIAL=y
CONFIG_UART_INTERRUPT_DRIVEN=y
CONFIG_UART_ASYNC_API=y
CONFIG_DMA=y
```

## boards/riscv/hpm6800evk/hpm6800evk_defconfig
```kconfig
CONFIG_SOC_HPM6880=y
CONFIG_SOC_SERIES_HPM68XX=y
CONFIG_BOARD_HPM6800EVK=y
CONFIG_XIP=y
CONFIG_PLIC=y
CONFIG_CONSOLE=y
CONFIG_UART_CONSOLE=y
CONFIG_PINCTRL=y
CONFIG_CLOCK_CONTROL=y
CONFIG_GPIO=y
CONFIG_BUILD_OUTPUT_HEX=y
CONFIG_NDEBUG_CONSOLE=y
CONFIG_SERIAL=y
CONFIG_UART_INTERRUPT_DRIVEN=y
CONFIG_DMA=y
```

## boards/shields/shield_case/Kconfig.shield
```kconfig
# Copyright (c) 2024 HPMicro
# SPDX-License-Identifier: Apache-2.0

# add set(SHIELD shield_case) in cmake or -DSHIELD=shield_case in command
# name.overlay name should be shield's name

DT_COMPAT_HPM_UART := hpmicro,hpm-uart

config SHIELD_CASE
	def_bool $(shields_list_contains,shield_case)

config SHIELD_CASE2
	def_bool $(dt_compat_enabled,$(DT_COMPAT_HPM_UART))
	depends on SHIELD_CASE
```

## drivers/Kconfig
```kconfig
# Copyright (c) 2023-2024 HPMicro
# SPDX-License-Identifier: BSD-3-Clause

menu "Device Drivers"

rsource "clock_control/Kconfig.hpmicro"
rsource "display/Kconfig.hpmicro"
rsource "serial/Kconfig.hpmicro"
rsource "pinctrl/Kconfig.hpmicro"
rsource "dma/Kconfig.hpmicro"
rsource "gpio/Kconfig.hpmicro"
rsource "can/Kconfig.hpmicro"
rsource "spi/Kconfig.hpmicro"
rsource "pwm/Kconfig.hpmicro"
rsource "adc/Kconfig.hpmicro"

endmenu
```

## drivers/adc/Kconfig.hpmicro
```kconfig
# Copyright (c) 2024 HPMicro
# SPDX-License-Identifier: Apache-2.0
DT_COMPAT_HPM_ADC12 := hpmicro,hpm-adc12
DT_COMPAT_HPM_ADC16 := hpmicro,hpm-adc16

config ADC_HPMICRO_ADC12
	bool "HPMICRO ADC12 driver"
	default y
	depends on DT_HAS_HPMICRO_HPM_ADC12_ENABLED
	select HAS_HPMSDK_ADC12
	help
	  Enable the HPMICRO ADC12 driver.

config ADC_HPMICRO_ADC16
	bool "HPMICRO ADC16 driver"
	default y
	depends on DT_HAS_HPMICRO_HPM_ADC16_ENABLED
	select HAS_HPMSDK_ADC16
	help
	  Enable the HPMICRO ADC16 driver.
```

## drivers/can/Kconfig.hpmicro
```kconfig
# HPMICRO CASTCAN configuration options

# Copyright (c) 2022-2024 HPMicro
# SPDX-License-Identifier: Apache-2.0

DT_COMPAT_HPM_CAN := hpmicro,hpm-can

config CAN_HPMICRO
	bool "HPMICRO CAN driver"
	default y
	depends on DT_HAS_HPMICRO_HPM_CAN_ENABLED
    select HAS_HPMSDK_CAN
    help
        Enable the HPMICRO CAN driver

DT_COMPAT_HPM_MCAN := hpmicro,hpm-mcan

config MCAN_HPMICRO
	bool "HPMICRO MCAN driver"
	default y
	depends on DT_HAS_HPMICRO_HPM_MCAN_ENABLED
    select HAS_HPMSDK_MCAN
    help
        Enable the HPMICRO MCAN driver

config CAN_MAX_FILTER
	int "Maximum number of concurrent active filters"
	default 4
	range 1 16
	help
	  Maximum number of filters supported by the can_add_rx_callback() API call.
```
