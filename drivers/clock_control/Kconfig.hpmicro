## drivers/clock_control/Kconfig.hpmicro
```kconfig
# Copyright (c) 2024-2026 HPMicro
# SPDX-License-Identifier: Apache-2.0

config CLOCK_CONTROL_HPMICRO
	bool "HPMICRO clock control driver"
	default y
	depends on DT_HAS_HPMICRO_HPM_CLOCK_ENABLED
    help
        Enable the HPMICRO PLL driver

config CLOCK_CONTROL_HPMICRO_PLLV1
	bool "HPMICRO clock control driver"
	default y
	depends on DT_HAS_HPMICRO_HPM_PLL_CLOCK_ENABLED
    select HAS_HPMSDK_PLLCTL
    help
        Enable the HPMICRO PLL driver

config CLOCK_CONTROL_HPMICRO_PLLV2
	bool "HPMICRO clock control pllv2 driver"
	default y
	depends on DT_HAS_HPMICRO_HPM_PLLV2_CLOCK_ENABLED
    select HAS_HPMSDK_PLLCTLV2
    help
        Enable the HPMICRO PLLV2 driver

config CLOCK_CONTROL_HPMICRO_CPU
	bool "HPMICRO CPU clock control driver"
	default y
	depends on DT_HAS_HPMICRO_HPM_CPU_CLOCK_ENABLED
	help
	  Configure HPMicro CPU and derived system clocks from devicetree.

config CLOCK_CONTROL_HPMICRO_CPU_INIT_PRIORITY
	int "HPMICRO CPU clock initialization priority"
	default 41
	depends on CLOCK_CONTROL_HPMICRO_CPU
	help
	  Initialize the CPU clock after the PLL clock controllers and the
	  HPM6300 SoC voltage setup.
```

## drivers/counter/Kconfig.hpmicro
```kconfig
# Copyright (c) 2026 HPMicro
# SPDX-License-Identifier: Apache-2.0

DT_COMPAT_HPM_GPT := hpmicro,hpm-gptimer

config GPT_HPMICRO
	bool "HPMICRO GPT driver"
	default y
	depends on DT_HAS_HPMICRO_HPM_GPTIMER_ENABLED
    select HAS_HPMSDK_GPTMRV2 if SOC_SERIES_HPM5100
    select HAS_HPMSDK_GPTMR if !SOC_SERIES_HPM5100
    help
        Enable the HPMICRO GPT driver
```

## drivers/entropy/Kconfig.hpmicro
```kconfig
# HPMICRO CASTCAN configuration options

# Copyright (c) 2026 HPMicro
# SPDX-License-Identifier: Apache-2.0

DT_COMPAT_HPM_RNG := hpmicro,hpm-rng

config RNG_HPMICRO
    bool "HPMICRO TRNG driver"
    default y
    depends on DT_HAS_HPMICRO_HPM_RNG_ENABLED
    select HAS_HPMSDK_RNG
    help
        Enable the HPMICRO RNG driver
```

## drivers/flash/Kconfig.hpmicro
```kconfig
# Copyright 2025 HPMicro
# SPDX-License-Identifier: Apache-2.0

DT_COMPAT_HPMICRO_HPM_FLASH := hpmicro,xpi

config FLASH_HPMICRO
	bool "HPMicro FLASH driver"
	default y
	depends on DT_HAS_HPMICRO_XPI_ENABLED
	select HAS_HPMSDK_FLASH
	select FLASH_HAS_DRIVER_ENABLED
	select FLASH_HAS_PAGE_LAYOUT
	select FLASH_HAS_EXPLICIT_ERASE
	help
	  Enable the hpmicro flash driver.
```

## drivers/hwinfo/Kconfig.hpmicro
```kconfig
# Copyright (c) 2026 HPMicro
# SPDX-License-Identifier: Apache-2.0
DT_COMPAT_HPM_UART := hpmicro,hpm-hwinfo

config HWINFO_HPMICRO
    bool "HPMICRO PPOR driver"
    default y
    depends on DT_HAS_HPMICRO_HPM_HWINFO_ENABLED
    help
      This option enables the PPOR driver for HPM SoC family.
```

## drivers/usb/udc/Kconfig.hpmicro
```kconfig
# Copyright (c) 2025-2026 HPMicro
# SPDX-License-Identifier: Apache-2.0

DT_COMPAT_HPM_UDC := hpmicro,hpm-udc

config UDC_HPMICRO
	bool "HPMicro USB Device controller driver"
	default y
	depends on DT_HAS_HPMICRO_HPM_UDC_ENABLED
	select HAS_HPMSDK_USB
	select NOCACHE_MEMORY if CPU_HAS_DCACHE
	select PINCTRL
	select UDC_BUF_FORCE_NOCACHE if DCACHE
	select UDC_DRIVER_HAS_HIGH_SPEED_SUPPORT
	select UDC_WORKQUEUE
	help
	  Enable support for hpmicro usb device driver.

config UDC_HPMICRO_EVENT_QUEUE_SIZE
	int "Number of queued USB controller events"
	depends on UDC_HPMICRO
	range 4 32
	default 16
	help
	  Number of USB controller events that can be queued between interrupt
	  and UDC workqueue context.
```

## drivers/watchdog/Kconfig.hpmicro
```kconfig
# Copyright (c) 2026 HPMicro
# SPDX-License-Identifier: Apache-2.0

DT_COMPAT_HPM_WDG := hpmicro,hpm-wdg

config WDG_HPMICRO
    bool "HPMICRO WDG driver"
    default y
    depends on DT_HAS_HPMICRO_HPM_WDG_ENABLED
    select HAS_HPMSDK_WDG
    help
        Enable the HPMICRO WDG driver

DT_COMPAT_HPM_EWDG := hpmicro,hpm-ewdg

config EWDG_HPMICRO
    bool "HPMICRO EWDG driver"
    default y
    depends on DT_HAS_HPMICRO_HPM_EWDG_ENABLED
    select HAS_HPMSDK_EWDG
    help
        Enable the HPMICRO EWDG driver
```

## dts/bindings/can/hpmicro,hpm-mcan.yaml
```yaml
# Copyright 2022 HPMicro
# SPDX-License-Identifier: Apache-2.0

description: HPMicro HPM MCAN

compatible: "hpmicro,hpm-mcan"

include: ["can-controller.yaml","pinctrl-device.yaml"]

properties:
  reg:
    required: true

  interrupts:
    required: true

  clocks:
    required: true
```

## dts/bindings/clock/hpmicro,hpm-cpu-clock.yaml
```yaml
# Copyright (c) 2026 HPMicro
# SPDX-License-Identifier: Apache-2.0

description: |
  HPMicro CPU clock domain. The parent clock selects a PLL output and records
  the CPU divider. AXI and AHB are derived from the resulting CPU clock.

compatible: "hpmicro,hpm-cpu-clock"

include: [clock-controller.yaml, base.yaml]

properties:
  node-name:
    type: int
    required: true
    description: HPM SDK clock_name_t value for this CPU clock.

  clocks:
    required: true
    description: Parent PLL output and CPU divider.

  axi-divider:
    type: int
    enum:
      - 1
      - 2
      - 3
      - 4
      - 5
      - 6
      - 7
      - 8
      - 9
      - 10
      - 11
      - 12
      - 13
      - 14
      - 15
      - 16
    description: AXI divider based on the divided CPU clock.

  ahb-divider:
    type: int
    enum:
      - 1
      - 2
      - 3
      - 4
      - 5
      - 6
      - 7
      - 8
      - 9
      - 10
      - 11
      - 12
      - 13
      - 14
      - 15
      - 16
    description: AHB divider based on the divided CPU clock.

  "#clock-cells":
    const: 0
```

## dts/bindings/clock/hpmicro,hpm-pll-clock.yaml
```yaml
# Copyright (c) 2024-2026 HPMicro
# SPDX-License-Identifier: Apache-2.0

description: |
  HPMicro PLL version 1. PLLv1 supports two modes:
  integer division mode, fraction division mode
  Output frequency is given by the following formula:
    integer: Fout = Fref / REFDIV * FBDIV_INT /POSDIV
    fraction: Fout = Fref / REFDIV * (FBDIV_FRAC + (FRAC / 2^24)) / POSDIV

compatible: "hpmicro,hpm-pll-clock"

include: [clock-controller.yaml, base.yaml]

properties:
  pll-frequency:
    type: int
    required: true
    description: |
      PLL frequency Hz

  pll-index:
    type: int
    required: true
    description: |
      PLL index
    enum:
      - 0
      - 1
      - 2
      - 3
      - 4

  integer-mode:
    type: boolean
    description: Use integer division mode instead of fractional division mode.

  "#clock-cells":
    const: 2

clock-cells:
  - clk-index
  - div

child-binding:
  description: |
    PLL division

  properties:
    src-name:
      type: int
      required: true
      description: |
        PLL divider node index

    div-i:
      type: int
      required: true
      description: |
        PLL divider index

    div-p:
      type: int
      required: true
      description: |
        PLL divider prescaler
```

## dts/bindings/clock/hpmicro,hpm-pllv2-clock.yaml
```yaml
# Copyright (c) 2024 HPMicro
# SPDX-License-Identifier: Apache-2.0

description: HPMicro PLL version 2.

compatible: "hpmicro,hpm-pllv2-clock"

include: [clock-controller.yaml, base.yaml]

properties:
  pll-frequency:
    type: int
    required: true
    description: |
      PLL frequency Hz

  pll-index:
    type: int
    required: true
    description: |
      PLL index
    enum:
      - 0
      - 1
      - 2
      - 3
      - 4

  "#clock-cells":
    const: 2

clock-cells:
  - clk-index
  - div

child-binding:
  description: |
    PLL division

  properties:
    src-name:
      type: int
      required: true
      description: |
        PLL divider node index

    div-i:
      type: int
      required: true
      description: |
        PLL divider index

    div-p:
      type: int
      required: true
      description: |
        PLL divider prescaler, freq = VCO / (1 + div-p / 5)
```

## dts/bindings/clock/hpmicro,hpm-second-clock.yaml
```yaml
# Copyright (c) 2024-2026 HPMicro
# SPDX-License-Identifier: Apache-2.0

description: |
  HPMicro derived clock. The parent clock identifies the upstream clock node.

compatible: "hpmicro,hpm-second-clock"

include: [clock-controller.yaml, base.yaml]

properties:
  node-name:
    type: int
    required: true
    description: |
      HPM SDK clock_name_t value for this derived clock node.

  clocks:
    required: true
    description: Parent PLL output and functional clock divider.

  "#clock-cells":
    const: 0
```

## dts/bindings/counter/hpmicro,hpm-counter.yaml
```yaml
# Copyright 2026 HPMicro
# SPDX-License-Identifier: Apache-2.0

description: HPMicro HPM GPT

compatible: "hpmicro,hpm-gptimer"

include: base.yaml

properties:
  reg:
    required: true

  interrupts:
    required: true

  gptfreq:
    type: int
    required: true
    description: gpt frequencies
```

## dts/bindings/display/hpmicro,hpm-mipi-dsi-phy.yaml
```yaml
# Copyright 2024, 2026 HPMicro
# SPDX-License-Identifier: Apache-2.0

description: HPMicro HPM MIPI DSI PHY

compatible: "hpmicro,hpm-mipi-dsi-phy"

include: ["base.yaml"]
```

## dts/bindings/display/hpmicro,hpm-mipi-dsi.yaml
```yaml
# Copyright 2024, 2026 HPMicro
# SPDX-License-Identifier: Apache-2.0

description: HPMicro HPM MIPI-DSI

compatible: "hpmicro,hpm-mipi-dsi"

include: ["base.yaml"]

properties:
  endpoint_in:
      type: phandle
      required: true
      description: video data source of the mipi-dsi
  id:
    type: int
    required: true
    description: mipi dsi instance number
  mipi_dsi_phy:
    type: phandle
    required: true
    description: mipi dsi phy node
  pixelmux:
    type: phandle
    required: true
    description: pixelmux node
```

## dts/bindings/entropy/hpmicro,hpm-entropy.yaml
```yaml
# Copyright 2026 HPMicro
# SPDX-License-Identifier: Apache-2.0

description: HPMicro HPM RNG

compatible: "hpmicro,hpm-rng"

include: base.yaml

properties:
  reg:
    required: true

  interrupts:
    required: true

  clk-name:
    type: int
    required: true
    description: RNG clock name

  clk-source:
    type: int
    required: true
    description: RNG clock source

  clk-divider:
    type: int
    required: true
    description: RNG clock divider
```

## dts/bindings/hwinfo/hpmicro,hpm-hwinfo.yaml
```yaml
# Copyright 2026 HPMicro
# SPDX-License-Identifier: Apache-2.0

description: HPMicro HPM HWINFO

compatible: "hpmicro,hpm-hwinfo"

include: base.yaml

properties:
  reg:
    required: true
```

## dts/bindings/pwm/hpmicro,hpm-pwmv2.yaml
```yaml
# Copyright 2024 HPMicro
# SPDX-License-Identifier: Apache-2.0

description: HPMICRO PWMv2 Module

compatible: "hpmicro,hpm-pwmv2"

include: [pwm-controller.yaml, base.yaml, pinctrl-device.yaml]

properties:
    reg:
      required: true
    
    clocks:
      required: true

    pinctrl-0:
      required: false

    period-init:
      type: int
      description: |
        Deprecated unused init hint (Hz). Reload is set by pwm_set_cycles;
        kept optional for overlay compatibility.
      required: false
    
    dead-zone-in-half-cycle:
      type: int
      description: pwm dead zone in half cycle, unit cycle
      required: false

    en-pwm-trig:
      type: boolean
      description: Enable PWM trigger mode
      required: false

    "#pwm-cells":
      const: 3

pwm-cells:
  - channel
  - period
  - flags
```

## dts/bindings/usb/hpmicro,hpm-udc.yaml
```yaml
# Copyright 2025 hpmicro
# SPDX-License-Identifier: Apache-2.0

description: HPMICRO USB device controller

compatible: "hpmicro,hpm-udc"

include: ["usb-ep.yaml", "pinctrl-device.yaml"]

properties:
  reg:
    required: true

  interrupts:
    required: true

  clk-name:
    type: int
    required: true
    description: USB clock name

  use-internal-vbus:
    type: boolean
    description: |
      Use the USB PHY internal VBUS/session-valid override for this controller
      instance.

      This is needed on board/package combinations where the USB controller is
      used in device mode but the SoC package or board wiring does not provide
      a usable external VBUS sense signal to the USB PHY. Without a valid VBUS
      indication the software stack may enable the controller successfully, but
      the device will not respond to host enumeration. Do not enable this
      property on boards that have a real VBUS sense path and rely on hardware
      VBUS detection.

  power-active-high:
    type: boolean
    description: |
      Configure the USB port power-control output as active high.

      This describes the board-level polarity of the USB power-enable signal
      associated with the controller. It is typically used on boards where the
      USB_PWR pin drives an external VBUS power switch with active-high enable
      polarity. Leave this property absent if the default hardware polarity is
      correct for the board.

  power-stable-delay-ms:
    type: int
    default: 0
    description: |
      Delay, in milliseconds, after applying USB port power-control settings
      and before completing controller initialization.

      Board designs with an external VBUS power switch may need a short delay
      so the switched VBUS rail and its decoupling capacitors settle before the
      USB PHY/controller starts device operation. Use 0 when no stabilization
      delay is required.
```

## dts/bindings/video/hpmicro,hpm-mipi-csi-phy.yaml
```yaml
# Copyright 2024, 2026 HPMicro
# SPDX-License-Identifier: Apache-2.0

description: HPMicro HPM MIPI CSI PHY

compatible: "hpmicro,hpm-mipi-csi-phy"

include: ["base.yaml"]
```

## dts/bindings/video/hpmicro,hpm-mipi-csi.yaml
```yaml
# Copyright 2024, 2026 HPMicro
# SPDX-License-Identifier: Apache-2.0

description: HPMicro HPM MIPI CSI

compatible: "hpmicro,hpm-mipi-csi"

include: [base.yaml]

properties:
  reg:
    required: true

  mipi_csi_phy:
    type: phandle
    required: true

  interrupts:
    required: true

  clocks:
    required: true
```

## dts/bindings/watchdog/hpmicro,hpm-ewdg.yaml
```yaml
# Copyright 2026 HPMicro
# SPDX-License-Identifier: Apache-2.0

description: HPMicro HPM EWDG

compatible: "hpmicro,hpm-ewdg"

include: base.yaml

properties:
  reg:
    required: true

  interrupts:
    required: true

  reset_none_intr:
    description: Disable reset on watchdog timeout
    type: boolean
    required: false
```

## dts/bindings/watchdog/hpmicro,hpm-wdg.yaml
```yaml
# Copyright 2026 HPMicro
# SPDX-License-Identifier: Apache-2.0

description: HPMicro HPM WDG

compatible: "hpmicro,hpm-wdg"

include: base.yaml

properties:
  reg:
    required: true

  interrupts:
    required: true
```

## snippets/ethernet/boards/hpm6300evk.conf
```kconfig
# Copyright (c) 2026 HPMicro
# SPDX-License-Identifier: Apache-2.0

CONFIG_ETH_HPM_TX_DELAY=0
CONFIG_ETH_HPM_RX_DELAY=0
CONFIG_ETH_HPM_RGMII=n
CONFIG_ETH_HPM_RMII=y
```
