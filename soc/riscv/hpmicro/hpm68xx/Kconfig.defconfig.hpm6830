## soc/riscv/hpmicro/hpm68xx/Kconfig.defconfig.hpm6830
```kconfig
# Copyright (c) 2024 HPMicro
# SPDX-License-Identifier: Apache-2.0

if SOC_HPM6830

config SOC
	string
	default "hpm6830"

config SYS_CLOCK_TICKS_PER_SEC
	default 1000

config MAIN_FREQUENCY
	int "SOC 6830 MAIN FREQUENCY(ABOVE 384M)"
	default 500000000

config MAIN_STACK_SIZE
	default 4096

config IDLE_STACK_SIZE
	default 2048

config TEST_EXTRA_STACK_SIZE
	default 2048

endif # SOC_HPM6830
```

## soc/riscv/hpmicro/hpm68xx/Kconfig.defconfig.hpm6850
```kconfig
# Copyright (c) 2024 HPMicro
# SPDX-License-Identifier: Apache-2.0

if SOC_HPM6850

config SOC
	string
	default "hpm6850"

config SYS_CLOCK_TICKS_PER_SEC
	default 1000

config MAIN_FREQUENCY
	int "SOC 6850 MAIN FREQUENCY(ABOVE 384M)"
	default $(dt_node_int_prop_int,$(dt_nodelabel_path,clk),clock-frequency)

config MAIN_STACK_SIZE
	default 4096

config IDLE_STACK_SIZE
	default 2048

config TEST_EXTRA_STACK_SIZE
	default 2048

endif # SOC_HPM6850
```

## soc/riscv/hpmicro/hpm68xx/Kconfig.defconfig.series
```kconfig
# Copyright (c) 2024 HPMicro
# SPDX-License-Identifier: Apache-2.0

if SOC_SERIES_HPM68XX

config SOC_SERIES
	default "hpm68xx"

config SYS_CLOCK_HW_CYCLES_PER_SEC
	default 24000000

config KERNEL_ENTRY
	default "_start"

config RISCV_GENERIC_TOOLCHAIN
	default y if "$(ZEPHYR_TOOLCHAIN_VARIANT)" = "zephyr"
	default n

config RISCV_SOC_INTERRUPT_INIT
	default y

config RISCV_HAS_CPU_IDLE
	default y

config RISCV_HAS_PLIC
	default y

config RISCV_GP
	default y

config 2ND_LVL_ISR_TBL_OFFSET
	default 12

config 2ND_LVL_INTR_00_OFFSET
	default 11

config MAX_IRQ_PER_AGGREGATOR
	default 127

config NUM_IRQS
	default 140

source "${ZEPHYR_SDK_GLUE_MODULE_DIR}/soc/riscv/hpmicro/hpm68xx/Kconfig.defconfig.hpm68*"

endif # SOC_SERIES_HPM68XX
```

## soc/riscv/hpmicro/hpm6xxx/Kconfig.series
```kconfig
# Copyright (c) 2023 HPMicro
# SPDX-License-Identifier: Apache-2.0

config SOC_SERIES_HPM6XXX
	bool "HPMicro HPM6200_6E00 Series"
	select RISCV
	select SOC_FAMILY_RISCV_PRIVILEGED
	select SOC_FAMILY_HPM
	select ZEPHYR_HPM_SDK_MODULE
	help
	  Enable support for HPMicro HPM6200_6E00 series SoC
```

## soc/riscv/hpmicro/hpm6xxx/Kconfig.soc
```kconfig
# Copyright (c) 2023 HPMicro
# SPDX-License-Identifier: Apache-2.0

choice
	prompt "HPMicro HPM6xxx Selection"
	depends on SOC_SERIES_HPM6XXX

config SOC_HPM6360
	bool "SOC_HPM6360"
	select ATOMIC_OPERATIONS_BUILTIN
	select INCLUDE_RESET_VECTOR
	select RISCV_ISA_EXT_M
	select RISCV_ISA_EXT_A
    select RISCV_ISA_EXT_C
	select RISCV_ISA_RV32I
	select RISCV_ISA_EXT_ZICSR
	select RISCV_ISA_EXT_ZIFENCEI
	select HAS_HPMSDK_PLLCTL
	select HAS_HPMSDK_PMP
	select HAS_HPMSDK_PCFG

config SOC_HPM6750
	bool "SOC_HPM6750"
	select ATOMIC_OPERATIONS_BUILTIN
	select INCLUDE_RESET_VECTOR
	select RISCV_ISA_EXT_M
	select RISCV_ISA_EXT_A
    select RISCV_ISA_EXT_C
	select RISCV_ISA_RV32I
	select RISCV_ISA_EXT_ZICSR
	select RISCV_ISA_EXT_ZIFENCEI
	select HAS_HPMSDK_PLLCTL
	select HAS_HPMSDK_PMP
	select HAS_HPMSDK_PCFG

endchoice


if SOC_SERIES_HPM6XXX

config HAS_HPMICRO_CAN
    bool "mcu support castcan"

config HAS_HPMICRO_ADC12
	bool "mcu support adc12"

config HAS_HPMICRO_ADC16
	bool "mcu support adc12"

endif # SOC_SERIES_HPM6XXX
```
