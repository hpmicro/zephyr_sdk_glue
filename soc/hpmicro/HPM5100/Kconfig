## soc/hpmicro/HPM5100/Kconfig
```kconfig
# Copyright (c) 2026 HPMicro
# SPDX-License-Identifier: Apache-2.0

config SOC_SERIES_HPM5100
	select RISCV
	select RISCV_PRIVILEGED
	select RISCV_HAS_PLIC
	select RISCV_MACHINE_TIMER
	select RISCV_SOC_HAS_GP_RELATIVE_ADDRESSING
	select DYNAMIC_INTERRUPTS
	help
	  Enable support for HPMicro HPM5151 SoCs.

config SOC_HPM51_COMMON
	bool
	select ATOMIC_OPERATIONS_C
	select INCLUDE_RESET_VECTOR
	select RISCV_ISA_EXT_M
	select RISCV_ISA_EXT_A
	select RISCV_ISA_EXT_C
	select RISCV_ISA_EXT_ZICSR
	select RISCV_ISA_EXT_ZIFENCEI
	select CPU_HAS_DCACHE
	select CPU_HAS_ICACHE
	select RISCV_PMP if !MCUBOOT
	select ARCH_HAS_NOCACHE_MEMORY_SUPPORT

config SOC_HPM5151
	bool
	select SOC_HPM51_COMMON

if SOC_SERIES_HPM5100

choice
	prompt "Base CPU ISA options"
	default HPM51_RV32I

config HPM51_RV32I
	bool "RISCV32 CPU ISA"
	select RISCV_ISA_RV32I

config HPM51_RV32E
	bool "RISCV32E CPU ISA"
	select RISCV_ISA_RV32E

endchoice

choice
	prompt "FPU options"
	default HPM51_NO_FPU

config HPM51_NO_FPU
	bool "No FPU"

config HPM51_SINGLE_PRECISION_FPU
	bool "Single precision FPU"
	select CPU_HAS_FPU

endchoice

endif # SOC_SERIES_HPM5100
```

## soc/hpmicro/HPM5100/Kconfig.soc
```kconfig
# Copyright (c) 2026 HPMicro
# SPDX-License-Identifier: Apache-2.0

config SOC_SERIES_HPM5100
	bool
	select SOC_FAMILY_HPM
	select HAS_HPMSDK_PLLCTLV2
	select HAS_HPMSDK_PCFG
	help
	  Enable support for HPMicro HPM5151 SoCs.

config SOC_SERIES
	default "HPM5100" if SOC_SERIES_HPM5100

config SOC_HPM5151
	bool
	select SOC_SERIES_HPM5100

config SOC
	default "HPM5151" if SOC_HPM5151
```

## soc/hpmicro/HPM5300/Kconfig
```kconfig
# Copyright (c) 2026 HPMicro
# SPDX-License-Identifier: Apache-2.0

config SOC_SERIES_HPM5300
	select RISCV
	select RISCV_PRIVILEGED
	select RISCV_HAS_PLIC
	select RISCV_MACHINE_TIMER
	select RISCV_SOC_HAS_GP_RELATIVE_ADDRESSING
	select DYNAMIC_INTERRUPTS
	help
	  Enable support for HPMicro HPM5361 SoCs.

config SOC_HPM53_COMMON
	bool
	select ATOMIC_OPERATIONS_C
	select INCLUDE_RESET_VECTOR
	select RISCV_ISA_EXT_M
	select RISCV_ISA_EXT_A
	select RISCV_ISA_EXT_C
	select RISCV_ISA_EXT_ZICSR
	select RISCV_ISA_EXT_ZIFENCEI
	select CPU_HAS_DCACHE
	select CPU_HAS_ICACHE
	select RISCV_PMP if !MCUBOOT
	select ARCH_HAS_NOCACHE_MEMORY_SUPPORT

config SOC_HPM5361
	bool
	select SOC_HPM53_COMMON

config SOC_HPM5301
	bool
	select SOC_HPM53_COMMON

config SOC_HPM5321
	bool
	select SOC_HPM53_COMMON

config SOC_HPM5331
	bool
	select SOC_HPM53_COMMON

if SOC_SERIES_HPM5300

choice
	prompt "Base CPU ISA options"
	default HPM53_RV32I

config HPM53_RV32I
	bool "RISCV32 CPU ISA"
	select RISCV_ISA_RV32I

config HPM53_RV32E
	bool "RISCV32E CPU ISA"
	select RISCV_ISA_RV32E

endchoice

choice
	prompt "FPU options"
	default HPM53_NO_FPU

config HPM53_NO_FPU
	bool "No FPU"

config HPM53_SINGLE_PRECISION_FPU
	bool "Single precision FPU"
	select CPU_HAS_FPU

config HPM53_DOUBLE_PRECISION_FPU
	bool "Double precision FPU"
	select CPU_HAS_FPU_DOUBLE_PRECISION

endchoice

endif # SOC_SERIES_HPM5300
```

## soc/hpmicro/HPM5300/Kconfig.soc
```kconfig
# Copyright (c) 2026 HPMicro
# SPDX-License-Identifier: Apache-2.0

config SOC_SERIES_HPM5300
	bool
	select SOC_FAMILY_HPM
	select HAS_HPMSDK_PLLCTLV2
	select HAS_HPMSDK_PCFG
	help
	  Enable support for HPMicro HPM5300 series SoCs.

config SOC_SERIES
	default "HPM5300" if SOC_SERIES_HPM5300

config SOC_HPM5301
	bool
	select SOC_SERIES_HPM5300

config SOC_HPM5321
	bool
	select SOC_SERIES_HPM5300

config SOC_HPM5331
	bool
	select SOC_SERIES_HPM5300

config SOC_HPM5361
	bool
	select SOC_SERIES_HPM5300

config SOC
	default "HPM5301" if SOC_HPM5301
	default "HPM5321" if SOC_HPM5321
	default "HPM5331" if SOC_HPM5331
	default "HPM5361" if SOC_HPM5361
```

## soc/hpmicro/HPM5E00/Kconfig.soc
```kconfig
# Copyright (c) 2026 HPMicro
# SPDX-License-Identifier: Apache-2.0

config SOC_SERIES_HPM5E00
	bool
	select SOC_FAMILY_HPM
	select HAS_HPMSDK_PLLCTLV2
	select HAS_HPMSDK_PCFG
	help
	  Enable support for HPMicro HPM5E series SoC

config SOC_SERIES
	default "HPM5E00" if SOC_SERIES_HPM5E00

config SOC_HPM5E11
	bool
	select SOC_SERIES_HPM5E00

config SOC_HPM5E31
	bool
	select SOC_SERIES_HPM5E00

config SOC_HPM5E3Y
	bool
	select SOC_SERIES_HPM5E00

config SOC
	default "HPM5E11" if SOC_HPM5E11
	default "HPM5E31" if SOC_HPM5E31
	default "HPM5E3Y" if SOC_HPM5E3Y
```

## soc/hpmicro/HPM6200/Kconfig
```kconfig
# Copyright (c) 2025 HPMicro
# SPDX-License-Identifier: Apache-2.0

config SOC_SERIES_HPM6200
	select RISCV
	select RISCV_PRIVILEGED
	select RISCV_HAS_PLIC
	select RISCV_MACHINE_TIMER
	select RISCV_SOC_HAS_GP_RELATIVE_ADDRESSING
	select DYNAMIC_INTERRUPTS
	help
	  Enable support for HPMicro HPM62 series SoC

config SOC_HPM62_COMMON
	bool
	select ATOMIC_OPERATIONS_C
	select INCLUDE_RESET_VECTOR
	select RISCV_ISA_EXT_M
	select RISCV_ISA_EXT_A
    select RISCV_ISA_EXT_C
	select RISCV_ISA_EXT_ZICSR
	select RISCV_ISA_EXT_ZIFENCEI
	select CPU_HAS_DCACHE
	select CPU_HAS_ICACHE
	select RISCV_PMP if !MCUBOOT

config SOC_HPM6220
	bool
	select SOC_HPM62_COMMON

config SOC_HPM6240
	bool
	select SOC_HPM62_COMMON

config SOC_HPM6260
	bool
	select SOC_HPM62_COMMON

config SOC_HPM6264
	bool
	select SOC_HPM62_COMMON

config SOC_HPM6280
	bool
	select SOC_HPM62_COMMON

config SOC_HPM6284
	bool
	select SOC_HPM62_COMMON
if SOC_SERIES_HPM6200

choice
	prompt "Base CPU ISA options"
	default HPM62_RV32I

config HPM62_RV32I
	bool "RISCV32 CPU ISA"
	select RISCV_ISA_RV32I

config HPM62_RV32E
	bool "RISCV32E CPU ISA"
	select RISCV_ISA_RV32E

endchoice

choice
	prompt "FPU options"
	default HPM62_NO_FPU

config HPM62_NO_FPU
	bool "No FPU"

config HPM62_SINGLE_PRECISION_FPU
	bool "Single precision FPU"
	select CPU_HAS_FPU

config HPM62_DOUBLE_PRECISION_FPU
	bool "Double precision FPU"
	select CPU_HAS_FPU_DOUBLE_PRECISION

endchoice

config SOC_ANDES_V5_HWDSP
	bool "AndeStar V5 DSP ISA"
	select RISCV_SOC_CONTEXT_SAVE
	depends on !RISCV_GENERIC_TOOLCHAIN
	help
		This option enables the AndeStar v5 hardware DSP, in order to
		support using the DSP instructions.

config SOC_ANDES_V5_PMA
	bool "Andes V5 Physical Memory Attribute (PMA)"
	default y
	select ARCH_HAS_NOCACHE_MEMORY_SUPPORT
	select HAS_HPMSDK_PMP
	help
		This option enables the Andes V5 PMA, in order to support SW to
		configure physical memory attribute by PMA CSRs. The address
		matching of Andes V5 PMA is like RISC-V PMP NAPOT mode
		(power-of-two alignment).

endif # SOC_SERIES_HPM6200
```

## soc/hpmicro/HPM6200/Kconfig.soc
```kconfig
# Copyright (c) 2025 HPMicro
# SPDX-License-Identifier: Apache-2.0
config SOC_SERIES_HPM6200
	bool
	select SOC_FAMILY_HPM
	select HAS_HPMSDK_PLLCTLV2
	select HAS_HPMSDK_PCFG
	help
	  Enable support for HPMicro HPM62 series SoC

config SOC_SERIES
	default "HPM6200" if SOC_SERIES_HPM6200

config SOC_HPM6220
	bool
	select SOC_SERIES_HPM6200

config SOC_HPM6240
	bool
	select SOC_SERIES_HPM6200

config SOC_HPM6260
	bool
	select SOC_SERIES_HPM6200

config SOC_HPM6264
	bool
	select SOC_SERIES_HPM6200

config SOC_HPM6280
	bool
	select SOC_SERIES_HPM6200

config SOC_HPM6284
	bool
	select SOC_SERIES_HPM6200

config SOC
	default "HPM6220" if SOC_HPM6220
	default "HPM6240" if SOC_HPM6240
	default "HPM6260" if SOC_HPM6260
	default "HPM6264" if SOC_HPM6264
	default "HPM6280" if SOC_HPM6280
	default "HPM6284" if SOC_HPM6284
```

## soc/hpmicro/HPM6300/Kconfig.soc
```kconfig
# Copyright (c) 2026 HPMicro
# SPDX-License-Identifier: Apache-2.0

config SOC_SERIES_HPM6300
	bool
	select SOC_FAMILY_HPM
	select HAS_HPMSDK_PLLCTLV2
	select HAS_HPMSDK_PCFG
	help
	  Enable support for HPMicro HPM63 series SoC

config SOC_SERIES
	default "HPM6300" if SOC_SERIES_HPM6300

config SOC_HPM6320
	bool
	select SOC_SERIES_HPM6300

config SOC_HPM6330
	bool
	select SOC_SERIES_HPM6300

config SOC_HPM6340
	bool
	select SOC_SERIES_HPM6300

config SOC_HPM6350
	bool
	select SOC_SERIES_HPM6300

config SOC_HPM6360
	bool
	select SOC_SERIES_HPM6300

config SOC_HPM6364
	bool
	select SOC_SERIES_HPM6300

config SOC
	default "HPM6320" if SOC_HPM6320
	default "HPM6330" if SOC_HPM6330
	default "HPM6340" if SOC_HPM6340
	default "HPM6350" if SOC_HPM6350
	default "HPM6360" if SOC_HPM6360
	default "HPM6364" if SOC_HPM6364
```

## soc/hpmicro/HPM6700/Kconfig.soc
```kconfig
# Copyright (c) 2023-2024 HPMicro
# SPDX-License-Identifier: Apache-2.0
config SOC_SERIES_HPM6700
	bool
	select SOC_FAMILY_HPM
	select HAS_HPMSDK_PLLCTL
	select HAS_HPMSDK_PCFG
	help
	  Enable support for HPMicro HPM67 series SoC

config SOC_SERIES
	default "HPM6700" if SOC_SERIES_HPM6700

config SOC_HPM6430
	bool
	select SOC_SERIES_HPM6700

config SOC_HPM6450
	bool
	select SOC_SERIES_HPM6700

config SOC_HPM6454
	bool
	select SOC_SERIES_HPM6700

config SOC_HPM64G0
	bool
	select SOC_SERIES_HPM6700

config SOC_HPM64A0
	bool
	select SOC_SERIES_HPM6700

config SOC_HPM6730
	bool
	select SOC_SERIES_HPM6700

config SOC_HPM6750
	bool
	select SOC_SERIES_HPM6700

config SOC_HPM6754
	bool
	select SOC_SERIES_HPM6700

config SOC
	default "HPM6430" if SOC_HPM6430
	default "HPM6450" if SOC_HPM6450
	default "HPM6454" if SOC_HPM6454
	default "HPM64G0" if SOC_HPM64G0
	default "HPM64A0" if SOC_HPM64A0
	default "HPM6730" if SOC_HPM6730
	default "HPM6750" if SOC_HPM6750
	default "HPM6754" if SOC_HPM6754
```

## soc/hpmicro/HPM6E00/Kconfig.soc
```kconfig
# Copyright (c) 2025 HPMicro
# SPDX-License-Identifier: Apache-2.0
config SOC_SERIES_HPM6E00
	bool
	select SOC_FAMILY_HPM
	select HAS_HPMSDK_PLLCTLV2
	select HAS_HPMSDK_PCFG
	help
	  Enable support for HPMicro HPM6E series SoC

config SOC_SERIES
	default "HPM6E00" if SOC_SERIES_HPM6E00

config SOC_HPM6E50
	bool
	select SOC_SERIES_HPM6E00

config SOC_HPM6E60
	bool
	select SOC_SERIES_HPM6E00

config SOC_HPM6E6Y
	bool
	select SOC_SERIES_HPM6E00

config SOC_HPM6E70
	bool
	select SOC_SERIES_HPM6E00

config SOC_HPM6E80
	bool
	select SOC_SERIES_HPM6E00

config SOC_HPM6E84
	bool
	select SOC_SERIES_HPM6E00

config SOC_HPM6E8Y
	bool
	select SOC_SERIES_HPM6E00

config SOC
	default "HPM6E50" if SOC_HPM6E50
	default "HPM6E60" if SOC_HPM6E60
	default "HPM6E6Y" if SOC_HPM6E6Y
	default "HPM6E70" if SOC_HPM6E70
	default "HPM6E80" if SOC_HPM6E80
	default "HPM6E84" if SOC_HPM6E84
	default "HPM6E8Y" if SOC_HPM6E8Y
```

## soc/hpmicro/HPM6P00/Kconfig.defconfig.series
```kconfig
# Copyright (c) 2026 HPMicro
# SPDX-License-Identifier: Apache-2.0

if SOC_SERIES_HPM6P00

config SOC_SERIES
	default "HPM6P00"

config SYS_CLOCK_HW_CYCLES_PER_SEC
	default 24000000

config KERNEL_ENTRY
	default "_start"

config RISCV_GENERIC_TOOLCHAIN
	default y if "$(ZEPHYR_TOOLCHAIN_VARIANT)" = "zephyr"
	default n

config ICACHE
	default y

config DCACHE
	default y

config RISCV_SOC_INTERRUPT_INIT
	default y

config 2ND_LVL_ISR_TBL_OFFSET
	default 12

config 2ND_LVL_INTR_00_OFFSET
	default 11

config MAX_IRQ_PER_AGGREGATOR
	default 127

config NUM_IRQS
	default 256

source "${ZEPHYR_SDK_GLUE_MODULE_DIR}/soc/hpmicro/HPM6P00/Kconfig.defconfig.HPM6P*"

endif # SOC_SERIES_HPM6P00
```

## soc/hpmicro/HPM6P00/Kconfig.soc
```kconfig
# Copyright (c) 2026 HPMicro
# SPDX-License-Identifier: Apache-2.0

config SOC_SERIES_HPM6P00
	bool
	select SOC_FAMILY_HPM
	select HAS_HPMSDK_PLLCTLV2
	select HAS_HPMSDK_PCFG
	help
	  Enable support for HPMicro HPM6P series SoC

config SOC_SERIES
	default "HPM6P00" if SOC_SERIES_HPM6P00

config SOC_HPM6P31
	bool
	select SOC_SERIES_HPM6P00

config SOC_HPM6P41
	bool
	select SOC_SERIES_HPM6P00

config SOC_HPM6P81
	bool
	select SOC_SERIES_HPM6P00

config SOC
	default "HPM6P31" if SOC_HPM6P31
	default "HPM6P41" if SOC_HPM6P41
	default "HPM6P81" if SOC_HPM6P81
```

## soc/hpmicro/Kconfig
```kconfig
# Configuration options for hpmicro riscv SOCs supporting the riscv privileged
# architecture specification

# Copyright (c) 2024-2025 HPMicro
# SPDX-License-Identifier: Apache-2.0
config SOC_FAMILY_HPM
	select ZEPHYR_HPM_SDK_MODULE	
	select LINKER_USE_PINNED_SECTION

if SOC_FAMILY_HPM

rsource "${ZEPHYR_SDK_GLUE_MODULE_DIR}/soc/hpmicro/*/Kconfig"

config USE_DT_CODE_PARTITION
	default y if BOOTLOADER_MCUBOOT

config HPM_BOOT_HEADER
	bool "HPMicro boot header Struct included in the image"
	default y if XIP
	depends on !BOOTLOADER_MCUBOOT
	help
	  HPMicro bootrom use this struct to boot the image, if first stage bootloader is used, this must be N.

if HPM_BOOT_HEADER

config BOOT_NOR_CFG_OPTION_OFFSET
	hex "Nor flash config block offset22"
	default 0x400
	depends on !USE_DT_CODE_PARTITION
	help
	  HPMicro nor flash support information start offset

config BOOT_HEADER_LOAD_OFFSET
	hex "Bootheader config block offset"
	default 0x1000
	depends on !USE_DT_CODE_PARTITION
	help
	  HPMicro boot header symbol information start offset

endif

config APP_LOAD_ADDR_OFFSET
	hex "APP load offset"
	default 0x3000
	help
	  HPMicro app image start offset

config ROM_START_OFFSET
	default APP_LOAD_ADDR_OFFSET if HPM_BOOT_HEADER

if BOOTLOADER_MCUBOOT

config HAS_FLASH_LOAD_OFFSET
	default y

config MCUBOOT_GENERATE_UNSIGNED_IMAGE
	default y

config MCUBOOT_GENERATE_CONFIRMED_IMAGE
	default y

config ROM_START_OFFSET
	default 0x200

endif # BOOTLOADER_MCUBOOT
endif # SOC_FAMILY_HPM
```

## twister/zephyr_samples/basic/blinky/sample.yaml
```yaml
# Copyright (c) 2026 HPMicro
# SPDX-License-Identifier: Apache-2.0

sample:
  name: Blinky Sample
tests:
  hpmicro.sample.basic.blinky:
    harness: led
    tags:
    - hpmicro_verified
    - gpio
    depends_on:
    - gpio
    filter: dt_enabled_alias_with_parent_compat("led0", "gpio-leds")
    required_snippets:
    - blinky
    platform_allow: &platforms
    - hpm5100evk
    - hpm5300evk
    - hpm5301evklite
    - hpm5e00evk
    - hpm6200evk
    - hpm6300evk
    - hpm6750evk2
    - hpm6800evk
    - hpm6e00evk
    - hpm6p00evk
    integration_platforms: *platforms
```

## twister/zephyr_samples/basic/blinky_pwm/sample.yaml
```yaml
# Copyright (c) 2026 HPMicro
# SPDX-License-Identifier: Apache-2.0

sample:
  name: Blink LED (PWM based)
tests:
  hpmicro.sample.basic.blinky_pwm:
    harness: console
    harness_config:
      type: multi_line
      ordered: true
      regex:
      - PWM-based blinky
      - Calibrating for channel [0-9]+
      - Done calibrating; maximum/minimum periods [0-9]+/[0-9]+ nsec
      - Using period [0-9]+
      - Using period [0-9]+
    tags:
    - hpmicro_verified
    - pwm
    depends_on:
    - pwm
    filter: dt_alias_exists("pwm-led0") and dt_compat_enabled("pwm-leds")
    required_snippets:
    - blinky_pwm
    platform_allow: &platforms
    - hpm5100evk
    - hpm5300evk
    - hpm5e00evk
    - hpm6200evk
    - hpm6300evk
    - hpm6750evk2
    - hpm6e00evk
    - hpm6p00evk
    integration_platforms: *platforms
```

## twister/zephyr_samples/basic/button/sample.yaml
```yaml
# Copyright (c) 2026 HPMicro
# SPDX-License-Identifier: Apache-2.0

sample:
  name: Button Sample
tests:
  hpmicro.sample.basic.button:
    build_only: true
    tags:
    - hpmicro_verified
    - gpio
    depends_on:
    - gpio
    filter: dt_alias_exists("sw0")
    platform_allow: &platforms
    - hpm5100evk
    - hpm5300evk
    - hpm5301evklite
    - hpm5e00evk
    - hpm6200evk
    - hpm6300evk
    - hpm6750evk2
    - hpm6800evk
    - hpm6e00evk
    - hpm6p00evk
    integration_platforms: *platforms
```

## twister/zephyr_samples/drivers/adc/adc_dt/sample.yaml
```yaml
# Copyright (c) 2026 HPMicro
# SPDX-License-Identifier: Apache-2.0

sample:
  name: ADC devicetree driver sample (HPMicro)
tests:
  hpmicro.sample.drivers.adc.adc_dt:
    harness: console
    harness_config:
      type: multi_line
      ordered: true
      regex:
      - 'ADC reading\[\d+\]:'
      - '- .+, channel \d+: -?\d+'
    tags:
    - hpmicro_verified
    - adc
    depends_on:
    - adc
    filter: dt_node_has_prop("/zephyr,user","io-channels")
    required_snippets:
    - adc_dt
    platform_allow: &platforms
    - hpm5100evk
    - hpm5300evk
    - hpm5301evklite
    - hpm5e00evk
    - hpm6200evk
    - hpm6300evk
    - hpm6750evk2
    - hpm6800evk
    - hpm6e00evk
    - hpm6p00evk
    integration_platforms: *platforms
```
