/*
 * Copyright 2024 HPMicro
 * SPDX-License-Identifier: Apache-2.0
 */
 
/ {
    aliases {
        eeprom-0 = &eeprom;
    };
};

&i2c0 {
	status = "okay";
	pinctrl-0 = <&pinmux_i2c0>;
	pinctrl-names = "default";

	eeprom: eeprom@50 {
		compatible = "atmel,at24";
		status = "okay";
		reg = <0x50>;
		size = <256>;
		address-width = <8>;
		timeout = <25>;
		pagesize = <16>;
	};
};
